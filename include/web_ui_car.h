#pragma once
// ── Tesla 车机横屏 UI — /car ──────────────────────────────────────────────────
// 目标：Tesla 车机浏览器（AMD Ryzen/Intel MCU），1920×1200 横屏触控。
// 特点：大字号（16~28px 基线）、大按钮（≥56px）、左导航 + 主内容、最少打字。
// Auth：复用 sessionStorage 'fsd_tok'；403 时回 / 输密码。
// API：完全复用 /api/status、/api/set、/api/reboot、/api/ota、/api/wifi-bridge/*。
//
// Tabs：仪表 / 控制 / CAN / 网络 / DNS / OTA / 测速 / 日志 / 设置（9 个）

#ifdef ARDUINO
#include <pgmspace.h>
#else
#define PROGMEM
#endif

#include "version.h"
#include "web_ui_diag_js.h"  // DIAG_SHARED_JS macro embedded mid-string below

const char CAR_HTML[] PROGMEM = R"rawliteral(<!DOCTYPE html>
<html lang="zh">
<head>
<meta charset="UTF-8">
<meta name="viewport" content="width=device-width,initial-scale=1,maximum-scale=1,user-scalable=no">
<title>特斯拉控制器 · 车机</title>
<style>
*{margin:0;padding:0;box-sizing:border-box}
html,body{height:100%;background:#0a0a0a;color:#e5e5e5;font-family:-apple-system,"PingFang SC","Microsoft YaHei",sans-serif;overflow:hidden;-webkit-tap-highlight-color:transparent;user-select:none;-webkit-user-select:none}
button{font-family:inherit;cursor:pointer}
.app{display:grid;grid-template-rows:88px 1fr;grid-template-columns:240px 1fr;grid-template-areas:"header header" "nav main";height:100vh;width:100vw}
.header{grid-area:header;display:flex;align-items:center;gap:32px;padding:0 32px;background:#141414;border-bottom:1px solid #222}
.logo{font-size:28px;font-weight:800;color:#e5e5e5;letter-spacing:2px}
.logo-ver{font-size:16px;color:#8a8a8a;font-weight:500;margin-left:8px}
.hstat{display:flex;gap:24px;margin-left:auto;font-size:18px;font-weight:600}
.hs{display:flex;align-items:center;gap:8px}
.hs .dot{width:12px;height:12px;border-radius:50%;background:#555}
.hs.ok .dot{background:#22c55e}
.hs.warn .dot{background:#f59e0b}
.hs.err .dot{background:#ef4444}
.nav{grid-area:nav;background:#141414;border-right:1px solid #222;padding:20px 12px;display:flex;flex-direction:column;gap:8px;overflow-y:auto}
.nbtn{height:88px;background:transparent;color:#a0a0a0;border:2px solid transparent;border-radius:12px;font-size:20px;font-weight:600;display:flex;align-items:center;gap:14px;padding:0 18px;text-align:left;transition:all .15s}
.nbtn .ic{font-size:28px}
.nbtn:active{background:rgba(255,255,255,.08)}
.nbtn.active{background:rgba(255,255,255,.22);color:#fff;border-color:transparent}
.main{grid-area:main;padding:28px;overflow-y:auto}
.main h2{font-size:24px;font-weight:700;color:#8a8a8a;letter-spacing:3px;margin-bottom:20px}
.page{display:none}
.page.show{display:block}
/* ── dashboard v1.5 (全新设计) ─────────────────── */
.cluster{position:relative;padding:30px 40px 24px;margin-bottom:24px;background:radial-gradient(ellipse 70% 55% at 50% 48%,#1a2c4e 0%,#0a0a0a 75%);border-radius:28px;overflow:hidden;min-height:660px;animation:cluster-in .6s cubic-bezier(.2,.8,.2,1)}
.cluster::before{content:'';position:absolute;inset:0;background:radial-gradient(ellipse 30% 22% at 50% 48%,rgba(56,189,248,.1) 0%,transparent 70%),radial-gradient(ellipse 12% 8% at 20% 30%,rgba(52,211,153,.05),transparent 70%),radial-gradient(ellipse 12% 8% at 80% 30%,rgba(239,68,68,.05),transparent 70%),repeating-linear-gradient(0deg,transparent 0 79px,rgba(255,255,255,.018) 79px 80px);pointer-events:none}
.scene{position:relative;display:grid;grid-template-columns:200px 1fr 200px;gap:20px;align-items:center;min-height:600px}
/* ── 挡位列 ── */
.c-gear{text-align:center;position:relative;z-index:2}
.gear-big{font-size:260px;font-weight:900;line-height:.82;font-family:-apple-system,'SF Pro Display',system-ui,sans-serif;letter-spacing:-16px;color:#8a8a8a;transform-origin:center center;transition:color .35s, transform .45s cubic-bezier(.2,.8,.2,1);text-shadow:0 6px 80px currentColor;display:inline-block;will-change:transform}
.cluster.driving .gear-big{transform:scale(.37)}
.gear-big.P{color:#60a5fa}
.gear-big.R{color:#f87171}
.gear-big.N{color:#a0a0a0}
.gear-big.D{color:#14b8a6}
.gear-big.pop{animation:gear-pop .55s cubic-bezier(.2,1.3,.3,1)}
.cluster.driving .gear-big.pop{animation:gear-pop-small .5s cubic-bezier(.2,1.25,.3,1)}
@keyframes gear-pop{0%{transform:scale(.55);opacity:.4}55%{transform:scale(1.2);opacity:1}100%{transform:scale(1);opacity:1}}
@keyframes gear-pop-small{0%{transform:scale(.2);opacity:.4}55%{transform:scale(.44);opacity:1}100%{transform:scale(.37);opacity:1}}
.ap-mini{margin-top:14px;padding:9px 22px;display:inline-flex;align-items:center;gap:10px;background:rgba(15,23,42,.55);border:1px solid rgba(30,41,59,.9);border-radius:22px;font-size:16px;color:#8a8a8a;letter-spacing:3px;font-weight:700;backdrop-filter:blur(6px)}
.ap-mini .apv{color:#8a8a8a}
.ap-mini .ap-dot{width:10px;height:10px;border-radius:50%;background:#475569;transition:all .3s}
.ap-mini.on{background:rgba(52,211,153,.1);border-color:rgba(52,211,153,.35)}
.ap-mini.on .apv{color:#34d399;animation:ap-pulse 2.2s ease-in-out infinite}
.ap-mini.on .ap-dot{background:#34d399;box-shadow:0 0 14px #34d399;animation:ap-dot-blink 1.6s ease-in-out infinite}
@keyframes ap-pulse{0%,100%{text-shadow:0 0 16px rgba(52,211,153,.55)}50%{text-shadow:0 0 32px rgba(52,211,153,.95),0 0 60px rgba(52,211,153,.5)}}
@keyframes ap-dot-blink{0%,100%{opacity:1}50%{opacity:.3}}
/* ── 速度环 (最大化) ── */
.speedo-wrap{position:relative;width:100%;max-width:860px;aspect-ratio:1;margin:0 auto}
.speedo-arc{position:absolute;inset:0;width:100%;height:100%;overflow:visible;filter:drop-shadow(0 0 36px rgba(56,189,248,.55));transition:filter .5s}
.speedo-arc circle{transition:stroke-dasharray .55s cubic-bezier(.3,.9,.3,1),stroke .8s ease}
.cluster.warn .speedo-arc{filter:drop-shadow(0 0 50px rgba(239,68,68,1));animation:arc-warn 1s ease-in-out infinite}
.cluster.warn .spd-huge{color:#ffffff;text-shadow:0 4px 100px rgba(239,68,68,.95),0 0 30px rgba(239,68,68,.7)}
@keyframes arc-warn{0%,100%{filter:drop-shadow(0 0 50px rgba(239,68,68,.9))}50%{filter:drop-shadow(0 0 80px rgba(239,68,68,1))}}
.speedo-inner{position:absolute;inset:13%;display:flex;flex-direction:column;align-items:center;justify-content:center;text-align:center;background:radial-gradient(circle at 50% 55%,rgba(15,23,42,.55) 0%,rgba(11,17,32,.2) 55%,transparent 72%);border-radius:50%}
.spd-huge{font-size:260px;font-weight:900;line-height:.8;letter-spacing:-6px;color:#f8fafc;font-variant-numeric:tabular-nums;font-family:-apple-system,'SF Pro Display',system-ui,sans-serif;text-shadow:0 4px 80px rgba(56,189,248,.35);will-change:transform;transition:text-shadow .3s, font-size .3s, color .3s}
.spd-huge.big3{font-size:220px;letter-spacing:-4px}
.spd-huge.tick{animation:spd-tick .5s ease-out}
@keyframes spd-tick{0%{transform:scale(1)}30%{transform:scale(1.06);text-shadow:0 6px 100px rgba(56,189,248,.75)}100%{transform:scale(1);text-shadow:0 4px 80px rgba(56,189,248,.35)}}
.spd-unit{margin-top:18px;font-size:30px;color:#475569;letter-spacing:12px;font-weight:700;text-transform:uppercase}
.spd-off{margin-top:24px;padding:10px 26px;background:rgba(251,191,36,.08);border:1px solid rgba(251,191,36,.4);border-radius:24px;font-size:20px;color:#fbbf24;font-weight:700;letter-spacing:1px;display:inline-flex;align-items:center;gap:12px;box-shadow:0 4px 24px rgba(251,191,36,.2)}
.spd-off .spd-off-sep{color:rgba(251,191,36,.4)}
/* ── 限速牌 (缩小) ── */
.c-limit{display:flex;flex-direction:column;align-items:center;gap:8px;position:relative;z-index:2}
.c-limit .l-src{font-size:12px;color:#8a8a8a;letter-spacing:3px;min-height:16px;font-weight:600;text-transform:uppercase}
.limit-sign{width:140px;height:140px;border-radius:50%;background:radial-gradient(circle at 30% 30%,#fff 0%,#f8fafc 70%);border:11px solid #dc2626;display:flex;flex-direction:column;align-items:center;justify-content:center;box-shadow:0 6px 36px rgba(220,38,38,.4),inset 0 3px 10px rgba(0,0,0,.08);transition:box-shadow .35s}
.limit-sign.pulse{animation:limit-flash .9s cubic-bezier(.2,.7,.2,1)}
@keyframes limit-flash{0%{box-shadow:0 6px 36px rgba(220,38,38,.4),inset 0 3px 10px rgba(0,0,0,.08)}35%{box-shadow:0 6px 80px rgba(220,38,38,.95),0 0 40px rgba(255,255,255,.4),inset 0 3px 10px rgba(0,0,0,.08)}100%{box-shadow:0 6px 36px rgba(220,38,38,.4),inset 0 3px 10px rgba(0,0,0,.08)}}
.limit-num{font-size:58px;font-weight:900;color:#0f172a;line-height:1;letter-spacing:-3px;font-family:-apple-system,system-ui,sans-serif}
.limit-unit{font-size:11px;color:#475569;font-weight:700;letter-spacing:1px;margin-top:-2px}
/* ── SOC 宽条 ── */
.soc-wide{margin-top:22px;padding:0 10px}
.soc-wide-head{display:flex;justify-content:space-between;align-items:baseline;margin-bottom:10px}
.soc-wide-lbl{font-size:13px;color:#8a8a8a;letter-spacing:4px;font-weight:700;text-transform:uppercase}
.soc-wide-val{font-size:32px;font-weight:900;color:#34d399;font-variant-numeric:tabular-nums;letter-spacing:-1px}
.soc-wide-val.low{color:#fbbf24}
.soc-wide-val.crit{color:#ef4444}
.soc-wide-bar{position:relative;height:14px;background:rgba(15,23,42,.9);border:1px solid rgba(30,41,59,.9);border-radius:7px;overflow:hidden}
.soc-wide-fill{height:100%;background:linear-gradient(90deg,#34d399 0%,#22c55e 100%);background-size:200% 100%;transition:width .55s cubic-bezier(.3,.9,.3,1);box-shadow:0 0 22px rgba(52,211,153,.5)}
.soc-wide-fill.low{background:linear-gradient(90deg,#fbbf24,#f59e0b);box-shadow:0 0 22px rgba(251,191,36,.5)}
.soc-wide-fill.crit{background:linear-gradient(90deg,#ef4444,#dc2626);box-shadow:0 0 22px rgba(239,68,68,.5);animation:soc-shimmer 2s linear infinite}
@keyframes soc-shimmer{0%{background-position:0 0}100%{background-position:-200% 0}}
/* ── 信息芯片 ── */
.chips{margin-top:18px;display:flex;gap:14px;justify-content:center;flex-wrap:wrap;padding:0 10px}
.chip{display:inline-flex;align-items:center;gap:10px;padding:11px 22px;background:rgba(15,23,42,.55);border:1px solid rgba(30,41,59,.9);border-radius:22px;font-size:19px;color:#e5e5e5;font-weight:700;backdrop-filter:blur(6px)}
.chip-ic{font-size:19px}
.chip-v{font-variant-numeric:tabular-nums;color:#e2e8f0}
/* ── fade 通用 ── */
.fade-el{transition:opacity .32s ease}
.fade-el.hide{opacity:0;pointer-events:none}
@keyframes cluster-in{from{opacity:0;transform:translateY(10px)}to{opacity:1;transform:translateY(0)}}
/* ── 仪表盘模式：导航栏变成窄图标栏（每项始终可点） ── */
.app{transition:grid-template-columns .35s ease}
.nav{transition:padding .25s ease}
.nbtn{transition:all .15s, padding .25s, height .25s, gap .25s}
.app.nav-collapsed{grid-template-columns:78px 1fr}
.app.nav-collapsed .nav{padding:14px 6px;gap:6px}
.app.nav-collapsed .nbtn{flex-direction:column;height:72px;padding:6px 0;gap:4px;font-size:11px;letter-spacing:1px;justify-content:center}
.app.nav-collapsed .nbtn .ic{font-size:26px;margin:0}
.panel{background:#141414;border:1px solid #222;border-radius:16px;padding:24px;margin-bottom:20px}
.ptitle{font-size:18px;font-weight:700;color:#e5e5e5;margin-bottom:18px;letter-spacing:1px}
.row{display:flex;align-items:center;gap:16px;padding:14px 0;border-bottom:1px solid #222}
.row:last-child{border-bottom:none}
.rlbl{font-size:20px;font-weight:600;flex:0 0 200px}
.rval{font-size:20px;color:#a0a0a0;font-family:monospace}
.info-ic{display:inline-flex;align-items:center;justify-content:center;width:20px;height:20px;border-radius:50%;border:1.5px solid #666;color:#a0a0a0;font-size:12px;font-weight:700;margin-left:8px;cursor:help;font-style:italic}
.bgroup{display:flex;gap:12px;flex:1}
.pill{flex:1;height:72px;background:rgba(255,255,255,.05);color:#a8a8a8;border:0;border-radius:12px;font-size:22px;font-weight:500;letter-spacing:1px;transition:background .15s,color .15s}
.pill:active{background:rgba(255,255,255,.14)}
.pill.active{background:rgba(255,255,255,.28);color:#fff;font-weight:600}
.pill.dis{opacity:.35;pointer-events:none}
.stepper{display:flex;align-items:center;gap:16px;flex:1}
.sbtn{width:72px;height:72px;background:rgba(255,255,255,.08);color:#e5e5e5;border:0;border-radius:12px;font-size:32px;font-weight:500}
.sbtn:active{background:rgba(255,255,255,.18)}
.sval{min-width:140px;height:72px;background:rgba(255,255,255,.05);border:0;border-radius:12px;display:flex;align-items:center;justify-content:center;font-size:32px;font-weight:700;color:#fff;font-variant-numeric:tabular-nums}
.tog{width:88px;height:48px;background:#3a3a3a;border-radius:24px;position:relative;transition:background .2s;flex:0 0 88px;cursor:pointer}
.tog.on{background:#22c55e}
.tog::after{content:'';position:absolute;top:4px;left:4px;width:40px;height:40px;background:#fff;border-radius:50%;transition:left .2s}
.tog.on::after{left:44px}
.actions{display:flex;gap:16px;margin-top:24px}
.abtn{flex:1;height:80px;background:#22c55e;color:#fff;border:none;border-radius:14px;font-size:22px;font-weight:700;letter-spacing:2px}
.abtn:active{transform:scale(.98)}
.abtn.red{background:#ef4444}
.abtn.blue{background:rgba(255,255,255,.12);color:#fff}
.abtn.gray{background:rgba(255,255,255,.06);color:#a0a0a0}
.toast{position:fixed;top:100px;left:50%;transform:translateX(-50%);background:#222;border:1px solid #444;color:#fff;padding:16px 32px;border-radius:12px;font-size:18px;font-weight:600;z-index:1000;opacity:0;pointer-events:none;transition:opacity .2s}
.toast.show{opacity:1}
.toast.err{border-color:#ef4444;color:#fca5a5}
.toast.ok{border-color:#22c55e;color:#86efac}
.info-grid{display:grid;grid-template-columns:repeat(2,1fr);gap:16px}
.info-item{background:rgba(255,255,255,.04);border:0;border-radius:10px;padding:14px 18px}
.info-lbl{font-size:13px;color:#8a8a8a;letter-spacing:2px;margin-bottom:4px;font-weight:600}
.info-val{font-size:20px;color:#e5e5e5;font-family:monospace;font-weight:600}
.stat-grid{display:grid;grid-template-columns:repeat(4,1fr);gap:16px;margin-bottom:20px}
.scard{background:rgba(255,255,255,.04);border:0;border-radius:12px;padding:20px 16px;text-align:center}
.snum{font-size:36px;font-weight:800;color:#fff;font-variant-numeric:tabular-nums;line-height:1}
.slbl{font-size:14px;color:#8a8a8a;margin-top:8px;letter-spacing:2px;font-weight:600}
.sunit{font-size:16px;color:#8a8a8a;margin-left:4px;font-weight:600}
.tip{font-size:14px;color:#8a8a8a;margin-top:8px;line-height:1.6}
.tip.tip-collapsed{display:none}
/* Panel-title info button — opens/closes all .tip blocks within the panel.
   Absolute-positioned in the panel's top-right corner so it lines up with
   .ptitle vertically without disturbing the existing title flow.
   Active state highlights when at least one tip in the panel is open. */
.panel{position:relative}
.info-toggle{position:absolute;top:22px;right:24px;cursor:pointer;margin-left:0}
.info-ic.active{background:#0ea5e9;color:#fff;border-color:#0284c7}
.disclaimer{background:rgba(239,68,68,.1);border:1px solid rgba(239,68,68,.35);border-radius:12px;padding:16px 20px;margin-bottom:20px;color:#fca5a5;font-size:16px;font-weight:600;line-height:1.6}
.ota-zone{border:3px dashed #333;border-radius:16px;padding:40px;text-align:center;background:rgba(255,255,255,.03);margin-bottom:20px}
.ota-zone.drag{border-color:#e5e5e5;background:rgba(255,255,255,.08)}
.ota-tip{font-size:20px;color:#a0a0a0;margin-bottom:16px}
.ota-fname{font-size:18px;color:#e5e5e5;margin:12px 0;font-family:monospace;word-break:break-all}
.progress{width:100%;height:20px;background:#2a2a2a;border-radius:10px;overflow:hidden;margin:16px 0;display:none}
.progress-bar{height:100%;background:linear-gradient(90deg,#22c55e,#4ade80);transition:width .2s}
.smart-rule{display:flex;align-items:center;gap:14px;padding:10px 0;font-size:18px;color:#e5e5e5}
.smart-rule input[type=number]{background:rgba(255,255,255,.06);color:#fff;border:0;border-radius:8px;padding:8px 10px;font-size:20px;text-align:center;font-weight:700;width:90px;-moz-appearance:textfield}
.smart-rule input::-webkit-outer-spin-button,.smart-rule input::-webkit-inner-spin-button{-webkit-appearance:none;margin:0}
.car-num{width:100px;font-size:22px;background:rgba(255,255,255,.06);border:0;color:#fff;border-radius:8px;padding:8px 10px;text-align:center;font-weight:700;font-variant-numeric:tabular-nums;-moz-appearance:textfield}
.car-num::-webkit-outer-spin-button,.car-num::-webkit-inner-spin-button{-webkit-appearance:none;margin:0}
.hw3ct-label{font-size:13px;color:#a0a0a0;text-align:center;margin-bottom:4px}
.hw3ct-sub{font-size:11px;color:#707070;text-align:center;margin-bottom:6px}
.hw3ct-grid{display:grid;grid-template-columns:repeat(5,1fr);gap:10px}
.ts-step{display:flex;align-items:stretch;background:rgba(255,255,255,.08);border-radius:10px;overflow:hidden;user-select:none;min-height:54px}
.ts-step-btn{flex:0 0 34%;background:transparent;border:0;color:#e5e5e5;font-size:24px;font-weight:500;cursor:pointer;padding:0;line-height:1;display:flex;align-items:center;justify-content:center;-webkit-tap-highlight-color:rgba(255,255,255,.12);touch-action:manipulation}
.ts-step-btn:active{background:rgba(255,255,255,.16)}
.ts-step-val{flex:1;display:flex;align-items:center;justify-content:center;gap:4px;color:#fff;font-size:20px;font-weight:600;font-variant-numeric:tabular-nums;padding:0 4px;line-height:1}
.ts-step-unit{font-size:11px;color:#8a8a8a;font-weight:500;align-self:center;position:relative;top:1px}
.ts-step-pfx{font-size:16px;color:#c0c0c0;font-weight:500}
.phone-link{position:fixed;bottom:20px;right:20px;background:#222;color:#a0a0a0;border:1px solid #333;border-radius:8px;padding:10px 16px;font-size:14px;text-decoration:none}
.pin-overlay{position:fixed;inset:0;background:rgba(11,17,32,.95);display:none;align-items:center;justify-content:center;z-index:2000}
.pin-overlay.show{display:flex}
.pin-box{background:#141414;border:1px solid #333;border-radius:20px;padding:40px;width:520px}
.pin-box h3{font-size:26px;color:#fff;margin-bottom:20px;text-align:center}
.pin-box input{width:100%;background:rgba(255,255,255,.06);border:0;border-radius:12px;padding:16px 20px;color:#fff;font-size:24px;text-align:center;letter-spacing:8px;font-weight:700;box-sizing:border-box}
.pin-box input:focus{outline:none;background:rgba(255,255,255,.1)}
.pw-wrap{position:relative;display:block;width:100%;box-sizing:border-box}
.pw-wrap>input{width:100%;padding-right:54px !important;box-sizing:border-box}
.pw-eye{position:absolute;right:10px;top:50%;transform:translateY(-50%);background:transparent;border:none;color:#a0a0a0;font-size:22px;padding:6px 10px;cursor:pointer;line-height:1;min-height:44px;min-width:44px;z-index:2}
.pw-eye:hover,.pw-eye:active{color:#e2e8f0}
.pin-err{color:#ef4444;font-size:16px;text-align:center;margin-top:12px;min-height:20px}
/* ── 测速页 ────────────────────────────────────────────────── */
.perf-speed{background:#141414;border-radius:16px;padding:24px 20px;margin-bottom:18px;text-align:center;position:relative;overflow:hidden}
.perf-speed-val{font-size:96px;font-weight:900;color:#fff;line-height:1;letter-spacing:-4px;font-variant-numeric:tabular-nums;transition:color .3s}
.perf-speed-val.amber{color:#f59e0b}
.perf-speed-val.red{color:#ef4444}
.perf-speed-lbl{font-size:14px;color:#8a8a8a;letter-spacing:4px;margin-top:8px;font-weight:700}
.perf-card{background:#141414;border:2px solid transparent;border-radius:16px;padding:24px;margin-bottom:16px;transition:border-color .4s,box-shadow .4s}
.perf-card.done{border-color:#22c55e;box-shadow:0 0 28px rgba(34,197,94,.28)}
.perf-head{display:flex;align-items:center;justify-content:space-between;margin-bottom:16px}
.perf-title{font-size:22px;font-weight:700;color:#e2e8f0;letter-spacing:1px}
.perf-badge{font-size:14px;font-weight:700;padding:6px 16px;border-radius:20px;letter-spacing:2px;transition:all .3s}
.perf-badge.idle{background:#222;color:#8a8a8a}
.perf-badge.armed{background:#3d2f00;color:#f59e0b}
.perf-badge.running{background:#0d2d1a;color:#22c55e;animation:perf-blink .7s ease-in-out infinite}
.perf-badge.done{background:rgba(255,255,255,.12);color:#fff}
@keyframes perf-blink{0%,100%{opacity:1}50%{opacity:.4}}
.perf-bar{height:6px;background:#222;border-radius:3px;overflow:hidden;margin-bottom:18px}
.perf-fill{height:100%;width:0%;border-radius:3px;transition:width .1s linear}
.perf-fill.accel{background:linear-gradient(90deg,#e5e5e5,#22c55e)}
.perf-fill.brake{background:linear-gradient(90deg,#f59e0b,#ef4444)}
.perf-result{display:flex;align-items:baseline;gap:10px;min-height:68px;margin-bottom:20px;flex-wrap:wrap}
.perf-val{font-size:60px;font-weight:800;color:#f8fafc;font-variant-numeric:tabular-nums;line-height:1}
.perf-unit{font-size:20px;color:#8a8a8a;font-weight:500}
.perf-entry{font-size:14px;color:#a0a0a0;background:#222;border-radius:6px;padding:5px 12px;align-self:center;margin-left:6px}
.perf-actions{display:flex;gap:14px}
.perf-arm{flex:1;height:76px;background:#c41530;color:#fff;border:none;border-radius:12px;font-size:22px;font-weight:700;letter-spacing:3px;transition:background .2s,opacity .2s}
.perf-arm:active:not(:disabled){transform:scale(.98)}
.perf-arm:disabled{opacity:.35;cursor:not-allowed}
.perf-reset{flex:0 0 140px;height:76px;background:#222;color:#a0a0a0;border:2px solid #333;border-radius:12px;font-size:18px;font-weight:700;letter-spacing:2px}
.perf-reset:active{transform:scale(.98)}
.perf-hist-head{display:flex;align-items:center;justify-content:space-between;margin:18px 2px 8px}
.perf-hist-t{font-size:14px;color:#8a8a8a;font-weight:700;letter-spacing:3px}
.perf-hist-clr{font-size:13px;color:#475569;cursor:pointer;background:none;border:none;padding:4px 8px}
.perf-hist-clr:active{color:#a0a0a0}
.perf-hist-row{display:flex;align-items:center;justify-content:space-between;padding:12px 16px;background:rgba(255,255,255,.04);border-radius:10px;margin-bottom:6px;border-left:4px solid transparent}
.perf-hist-row.accel{border-left-color:#e5e5e5}
.perf-hist-row.brake{border-left-color:#f59e0b}
.perf-hist-ts{font-size:13px;color:#8a8a8a}
.perf-hist-v{font-size:22px;font-weight:800;color:#f8fafc}
.perf-hist-u{font-size:14px;color:#a0a0a0;margin-left:4px}
.perf-hist-e{font-size:12px;color:#a0a0a0;background:#222;border-radius:5px;padding:4px 10px;margin-left:10px}
.perf-hist-empty{font-size:14px;color:#333;text-align:center;padding:16px}
.perf-disc{background:#3d2f00;border:2px solid #f59e0b;border-radius:14px;padding:18px 22px;margin-bottom:18px;color:#fde68a}
.perf-disc-t{font-size:18px;font-weight:700;margin-bottom:10px;color:#fbbf24;letter-spacing:1px}
.perf-disc-b{font-size:14px;line-height:1.9;margin-bottom:14px}
.perf-disc-b b{color:#fff;font-weight:700}
.perf-disc-btn{background:#f59e0b;color:#0a0a0a;border:none;border-radius:10px;padding:12px 22px;font-size:14px;font-weight:700;letter-spacing:2px}
.perf-disc-btn:active{transform:scale(.98)}
.perf-note{font-size:13px;color:#475569;text-align:center;padding:10px 0 4px}
/* ── 响应式：车机浏览器不全屏时 (~800-1200px) 或小屏设备 ─────────── */
@media (max-width:1400px){
  .app{grid-template-columns:160px 1fr;grid-template-rows:72px 1fr}
  .header{padding:0 18px;gap:18px}
  .logo{font-size:22px}
  .logo-ver{font-size:13px}
  .hstat{gap:16px;font-size:15px}
  .nbtn{height:68px;font-size:16px;padding:0 12px;gap:10px}
  .nbtn .ic{font-size:22px}
  .main{padding:18px}
  .main h2{font-size:20px;margin-bottom:14px}
}
@media (max-width:1000px){
  html,body{overflow:auto}
  .app{grid-template-rows:auto auto 1fr;grid-template-columns:1fr;grid-template-areas:"header" "nav" "main";height:auto;min-height:100vh}
  .header{flex-wrap:wrap;height:auto;padding:10px 14px;gap:10px}
  .hstat{width:100%;gap:10px;font-size:13px;flex-wrap:wrap}
  .nav{flex-direction:row;overflow-x:auto;overflow-y:hidden;padding:8px 10px;gap:6px;border-right:none;border-bottom:1px solid #222;-webkit-overflow-scrolling:touch}
  .nbtn{height:46px;flex:0 0 auto;white-space:nowrap;padding:0 14px;font-size:14px;border-radius:10px}
  .nbtn .ic{font-size:18px}
  .main{padding:14px}
  .stat-grid{grid-template-columns:repeat(2,1fr);gap:10px}
  .scard{padding:14px 10px}
  .snum{font-size:28px}
  .slbl{font-size:12px;letter-spacing:1px}
  .info-grid{grid-template-columns:1fr}
  /* 仪表盘缩放 */
  .cluster{padding:14px;min-height:auto}
  .scene{grid-template-columns:110px 1fr 96px;gap:8px;min-height:auto}
  .gear-big{font-size:140px;letter-spacing:-8px}
  .spd-huge{font-size:160px}
  .spd-huge.big3{font-size:130px}
  .spd-unit{font-size:18px;letter-spacing:6px}
  .limit-sign{width:96px;height:96px;border-width:7px}
  .limit-num{font-size:38px}
  .speedo-wrap{max-width:720px}
  .pin-box{width:92%;max-width:460px;padding:28px}
}
</style>
</head>
<body>

<a href="/?ui=phone" class="phone-link" title="切换到手机版">📱 手机版</a>

<div class="app">
  <!-- 顶栏 -->
  <div class="header">
    <div>
      <span class="logo">特斯拉控制器</span>
      <span class="logo-ver">v)rawliteral" FIRMWARE_VERSION R"rawliteral(</span>
    </div>
    <div class="hstat">
      <div class="hs" id="hsCAN"><span class="dot"></span><span id="hsCANTxt">CAN --</span></div>
      <div class="hs" id="hsWifi"><span class="dot"></span><span id="hsWifiTxt">Wi-Fi --</span></div>
      <div class="hs" id="hsTemp"><span>🌡 <span id="hsTempTxt">--°C</span></span></div>
      <div class="hs" id="hsHeap"><span>💾 <span id="hsHeapTxt">--KB</span></span></div>
    </div>
  </div>

  <!-- 左导航（仪表盘页自动收窄为图标栏） -->
  <div class="nav" id="nav">
    <button class="nbtn active" data-page="dash"><span class="ic">🏎</span>仪表</button>
    <button class="nbtn" data-page="ctrl"><span class="ic">⚙️</span>控制</button>
    <button class="nbtn" data-page="can"><span class="ic">📡</span>CAN</button>
    <button class="nbtn" data-page="net"><span class="ic">🌐</span>网络</button>
    <button class="nbtn" data-page="dns"><span class="ic">🛡</span>DNS</button>
    <button class="nbtn" data-page="ota"><span class="ic">⬆️</span>OTA</button>
    <button class="nbtn" data-page="perf"><span class="ic">🏁</span>测速</button>
    <button class="nbtn" data-page="log"><span class="ic">📋</span>日志</button>
    <button class="nbtn" data-page="set"><span class="ic">🔧</span>设置</button>
  </div>

  <div class="main">

    <!-- 默认 AP 密码未修改时的全局警告横幅 -->
    <div id="passWarn" style="display:none;background:linear-gradient(135deg,#7f1d1d,#991b1b);border:2px solid #ef4444;border-radius:12px;padding:14px 18px;margin-bottom:16px;color:#fee2e2">
      <div style="font-weight:700;font-size:17px;margin-bottom:6px">⚠️ 请立即修改 WiFi 密码</div>
      <div style="font-size:14px;color:#fecaca;margin-bottom:10px">当前使用默认密码 <code style="color:#fff;background:rgba(0,0,0,0.3);padding:1px 6px;border-radius:4px">12345678</code>，公共停车时任何人可连入修改您的车辆设置。请在手机版修改密码。</div>
      <button onclick="openPhone()" style="background:#fecaca;color:#7f1d1d;border:none;border-radius:8px;padding:10px 18px;font-size:14px;font-weight:700;cursor:pointer">打开手机版 →</button>
    </div>

    <!-- ───── 仪表 ───── -->
    <div class="page show" id="pg-dash">
      <div id="rowSafeMode" style="display:none;background:#7f1d1d;border:2px solid #ef4444;border-radius:12px;padding:16px 20px;margin-bottom:20px;color:#fca5a5;font-size:18px;font-weight:700;line-height:1.5">
        ⚠️ 安全模式 — 设备连续崩溃，CAN 已禁用。请重新刷写固件或恢复出厂。
      </div>
      <div class="cluster">
        <div class="scene">
          <!-- 左：挡位 + 自驾 -->
          <div class="c-gear fade-el hide" id="cGear">
            <div class="gear-big" id="gearBig"></div>
            <div class="ap-mini fade-el hide" id="apChip"><span class="ap-dot"></span>AP<span class="apv" id="vGwAp"></span></div>
          </div>
          <!-- 中：速度环 (最大化) -->
          <div class="speedo-wrap">
            <svg class="speedo-arc" viewBox="0 0 100 100" preserveAspectRatio="xMidYMid meet" aria-hidden="true">
              <defs>
                <linearGradient id="arcGrad" x1="0" y1="1" x2="1" y2="0">
                  <stop offset="0%"   stop-color="#22c55e"/>
                  <stop offset="65%"  stop-color="#fbbf24"/>
                  <stop offset="100%" stop-color="#ef4444"/>
                </linearGradient>
                <linearGradient id="arcBg" x1="0" y1="1" x2="1" y2="0">
                  <stop offset="0%" stop-color="rgba(30,41,59,.55)"/>
                  <stop offset="100%" stop-color="rgba(51,65,85,.85)"/>
                </linearGradient>
              </defs>
              <circle cx="50" cy="50" r="45" fill="none" stroke="url(#arcBg)" stroke-width="4" stroke-dasharray="212.06 283" transform="rotate(135 50 50)" stroke-linecap="round"/>
              <circle id="arcFill" cx="50" cy="50" r="45" fill="none" stroke="url(#arcGrad)" stroke-width="5" stroke-dasharray="0 283" transform="rotate(135 50 50)" stroke-linecap="round"/>
            </svg>
            <div class="speedo-inner">
              <div class="spd-huge" id="vSpeed">0</div>
              <div class="spd-off fade-el hide" id="spdOff">
                <span id="vOffsetPct"></span>
                <span class="spd-off-sep">·</span>
                <span>+<span id="vOffset"></span> km/h</span>
              </div>
            </div>
          </div>
          <!-- 右：限速牌 (小) -->
          <div class="c-limit fade-el hide" id="limitSign">
            <div class="l-src" id="vFusedSrc">&nbsp;</div>
            <div class="limit-sign">
              <div class="limit-num" id="vFused"></div>
            </div>
          </div>
        </div>
        <div class="soc-wide fade-el hide" id="socMini">
          <div class="soc-wide-head">
            <span class="soc-wide-lbl">电量</span>
            <span class="soc-wide-val" id="vSocWrap"><span id="vSoc"></span>%</span>
          </div>
          <div class="soc-wide-bar">
            <div class="soc-wide-fill" id="socFill" style="width:0%"></div>
          </div>
        </div>
        <div class="chips">
          <div class="chip fade-el hide" id="miBmsT"><span class="chip-ic">🔋</span><span class="chip-v"><span id="vBmsT"></span>°C</span></div>
          <div class="chip fade-el hide" id="rowCabinTemp"><span class="chip-ic">🌡</span><span class="chip-v"><span id="vCabinTemp"></span>°C</span></div>
          <div class="chip fade-el hide" id="rowChipTemp"><span class="chip-ic">🔥</span><span class="chip-v"><span id="vChipTemp"></span></span></div>
          <div class="chip fade-el hide" id="miUp"><span class="chip-ic">⏱</span><span class="chip-v" id="vUp"></span></div>
        </div>
      </div>

    </div>

    <!-- ───── 控制 ───── -->
    <div class="page" id="pg-ctrl">
      <h2>控制 · CONTROL</h2>
      <div class="disclaimer">⚠️ 仅用于技术探讨 · 所有改动风险自负 · 不建议在真实驾驶中启用</div>

      <div class="panel">
        <div class="ptitle">主开关</div>
        <div class="row"><div class="rlbl">功能启用</div><div class="tog" id="tgFsd" data-k="fsdEnable"></div><div class="rval">关闭后所有改写停止</div></div>
      </div>

      <div class="panel">
        <div class="ptitle">硬件型号</div>
        <div class="bgroup" id="grpHw">
          <button class="pill" data-v="1">HW3</button>
          <button class="pill" data-v="2">HW4</button>
          <button class="pill" data-v="0">Legacy</button>
        </div>
        <div class="tip" id="hwTip">按 FSD 协议版本选，不是按芯片型号。<br>HW3 = FSD V13 协议（HW3 芯片 / HW4 芯片跑 2026.8 及更早固件都是 V13）<br>HW4 = FSD V14 协议（仅 HW4 芯片 + 已升 V14 的固件）<br>Legacy = 老款 AP1/AP2</div>
      </div>

      <div class="panel">
        <div class="ptitle">速度模式</div>
        <div class="bgroup" id="grpSpd">
          <button class="pill" data-sp="0" data-hw3="轻松" data-hw4="平缓">平缓</button>
          <button class="pill" data-sp="1" data-hw3="标准" data-hw4="舒适">舒适</button>
          <button class="pill" data-sp="2" data-hw3="迅捷" data-hw4="标准">标准</button>
          <button class="pill" data-sp="3" data-hw3="" data-hw4="迅捷">迅捷</button>
          <button class="pill" data-sp="4" data-hw3="" data-hw4="狂飙">狂飙</button>
        </div>
        <div class="row" style="margin-top:12px">
          <div class="rlbl">模式来源</div>
          <div class="bgroup" id="grpPMode" style="flex:1">
            <button class="pill" data-pm="1">自动（拨杆）</button>
            <button class="pill" data-pm="0">手动</button>
          </div>
        </div>
        <div class="tip">🛈 "自动（拨杆）"时由驾驶模式按钮切换；"手动"时固定为上方选择的档位。</div>
      </div>

      <div class="panel" id="panelHw3" style="display:none">
        <div class="ptitle">HW3 速度偏移</div>
        <div class="row"><div class="rlbl">自动突破<span class="info-ic" onclick="hint('&lt;80 km/h 限速时自动把目标拉到 64/85/100，超过 80 透传原厂偏移')">i</span></div><div class="tog" id="tgAuto" data-k="hw3AutoSpeed"></div><div class="rval">&lt;80 自动拉到 64/85/100</div></div>
        <div class="row"><div class="rlbl">自定义<span class="info-ic" onclick="hint('按限速档位设定目标速度，覆盖上面的自动突破。≥80 限速始终透传原厂')">i</span></div><div class="tog" id="tgCustom" data-k="hw3CustomSpeed"></div><div class="rval">按档位设定目标速度</div></div>
        <div id="rowHw3Custom" style="display:none;padding:14px;background:rgba(255,255,255,.03);border-radius:10px;margin-top:6px">
          <div style="font-size:14px;color:#a0a0a0;margin-bottom:10px">遇到限速时的目标速度。Tesla 固件硬限 +50%。</div>
          <div class="hw3ct-grid" id="gridHw3CT"></div>
        </div>
        <div class="tip">&lt;80 走上面自动/自定义；≥80 用下面的高速加速。</div>
        <div class="row"><div class="rlbl">平滑减速<span class="info-ic" onclick="hint('限速下降时偏移缓慢降下避免急减速，提速仍立即生效。实验功能')">i</span></div><div class="tog" id="tgSlew" data-k="hw3OffsetSlew"></div><div class="rval">限速下降时缓降偏移</div></div>
        <div id="rowHw3SlewDiag" style="display:none;padding:14px;background:rgba(255,255,255,.03);border-radius:10px;margin-top:6px">
          <div style="display:flex;align-items:center;gap:16px;margin-bottom:10px">
            <div style="font-size:13px;color:#a0a0a0;flex:0 0 90px">下降速率</div>
            <div class="ts-step" style="flex:0 0 180px"><button class="ts-step-btn" onclick="slewStep(-1)">−</button><div class="ts-step-val"><span id="cSlewRate">--</span><span class="ts-step-unit">%/s</span></div><button class="ts-step-btn" onclick="slewStep(1)">+</button></div>
            <div id="cSlewKphHint" style="color:#707070;font-size:12px">≈ -- kph/s @60限速</div>
          </div>
          <div style="display:grid;grid-template-columns:repeat(3,1fr);gap:8px;font-family:monospace;font-size:13px;color:#a0a0a0">
            <div>目标 raw <span id="cSlewTarget" style="color:#e5e5e5">--</span></div>
            <div>发送 raw <span id="cSlewSent" style="color:#e5e5e5">--</span></div>
            <div>已缓降 <span id="cSlewCount" style="color:#fbbf24">0</span></div>
          </div>
        </div>
        <div class="row"><div class="rlbl">≥80 高速加速<span class="info-ic" onclick="hint('限速 ≥80 km/h 时按百分比增加偏移。默认关=原厂透传。Tesla 固件硬限 +50%')">i</span></div><div class="tog" id="tgHiSpd" data-k="hw3HighSpeedEnable"></div><div class="rval">≥80 按百分比加速</div></div>
        <div id="rowHw3HiSpdPanel" style="display:none;padding:14px;background:rgba(255,255,255,.03);border-radius:10px;margin-top:6px">
          <div style="font-size:14px;color:#a0a0a0;margin-bottom:10px">遇到限速路牌时按百分比加速。Tesla 固件硬限 +50%。</div>
          <div class="hw3ct-grid" id="gridHw3Hs"></div>
          <div style="font-size:13px;color:#a0a0a0;margin-top:10px;font-family:monospace" id="cHiSpdHint"></div>
        </div>
        <div class="row"><div class="rlbl">偏移编码<span class="info-ic" onclick="hint('不同 Tesla 固件对 0x3FD 偏移字节解码不同。PCT4 是多数车；若实际跑出的最高速明显低于目标，切 KPH5 再观察。')">i</span></div>
          <div class="bgroup" id="grpHw3Enc">
            <button class="pill" data-enc="1">PCT4（默认）</button>
            <button class="pill" data-enc="0">KPH5</button>
          </div>
        </div>
      </div>

      <div class="panel" id="panelHw4" style="display:none">
        <div class="ptitle">HW4 速度偏移</div>
        <div class="row"><div class="rlbl">偏移强度</div>
          <div class="ts-step" style="flex:0 0 200px">
            <button class="ts-step-btn" onclick="hw4Step(-1)">−</button>
            <div class="ts-step-val"><span id="cHw4Off">0</span><span class="ts-step-unit">raw ≈ <span id="cHw4OffKmh">0</span> km/h</span></div>
            <button class="ts-step-btn" onclick="hw4Step(1)">+</button>
          </div>
          <div class="rval">0~21（0=关，21≈+15 km/h）</div>
        </div>
        <div class="row"><div class="rlbl">ISA 限速覆盖</div><div class="tog" id="tgIsaOvr" data-k="isaOverride"></div><div class="rval">阻止 nav 限速压速（2024+ 固件必开）</div></div>
      </div>

      <div class="panel">
        <div class="ptitle">常用开关</div>
        <div class="row"><div class="rlbl">ISA 提示音</div><div class="tog" id="tgIsa" data-k="isaChime"></div><div class="rval">屏蔽限速提示音</div></div>
        <div class="row" id="rowEmerg" style="display:none"><div class="rlbl">紧急检测</div><div class="tog" id="tgEmerg" data-k="emergencyDet"></div><div class="rval">紧急制动/碰撞检测（HW4 专用）</div></div>
        <div class="row"><div class="rlbl">强制激活</div><div class="tog" id="tgForce" data-k="forceActivate"></div><div class="rval">无视车端"FSD 已选"判断直接注入</div></div>
        <div class="tip">🛈 实测车型上必须开，FSD 才能激活。不开时只在车机端广播"FSD 已选定"位时才触发注入，但目前所见车型该位都不广播，关着等于功能不工作。</div>
        <div class="row" id="rowTlssc" style="display:none"><div class="rlbl">TLSSC 旁路</div><div class="tog" id="tgTlssc" data-k="tlsscBypass"></div><div class="rval">激活帧附带置位 TLSSC 旁路</div></div>
        <div class="tip" id="tipTlssc" style="display:none">🛈 默认关。仅在 FSD 蓝方向盘点不亮的固件/地区试着开；未在每个固件验证。能正常激活的不要开，开了不一定有效甚至可能反向失败。</div>
        <div class="row" id="rowOvr" style="display:none"><div class="rlbl">忽略限速</div><div class="tog" id="tgOvr" data-k="overrideSL"></div><div class="rval">忽略路牌限速（Legacy 专用）</div></div>
        <div class="row" id="rowRvsl" style="display:none"><div class="rlbl">关闭视觉限速</div><div class="tog" id="tgRvsl" data-k="removeVSL"></div><div class="rval">屏蔽摄像头识别的限速（Legacy 专用）</div></div>
        <div class="row" id="rowLegOff" style="display:none"><div class="rlbl">Legacy 偏移</div>
          <div class="ts-step" style="flex:0 0 180px"><button class="ts-step-btn" onclick="legacyStep(-1)">−</button><div class="ts-step-val"><span class="ts-step-pfx">+</span><span id="cLegOff">--</span><span class="ts-step-unit">kph/mph</span></div><button class="ts-step-btn" onclick="legacyStep(1)">+</button></div>
          <div class="rval">0~33（遵循车辆单位）</div></div>
        <div id="rowGps2F8" style="display:none;padding:10px 12px;background:rgba(0,0,0,.25);border-radius:10px;margin-top:6px;font-family:monospace;font-size:12px">
          <div style="color:#a0a0a0;margin-bottom:6px">0x2F8 (760) Legacy 限速帧嗅探（只读，用来确认是否可改写）</div>
          <div style="display:grid;grid-template-columns:repeat(2,1fr);gap:4px;color:#e5e5e5">
            <div>可见：<span id="cGps2F8Seen">--</span></div>
            <div>帧数：<span id="cGps2F8Count">0</span></div>
            <div>周期：<span id="cGps2F8Period">-- ms</span></div>
            <div>用户偏移 raw：<span id="cGps2F8UserOff">--</span></div>
            <div style="grid-column:1 / -1">地图限速 raw：<span id="cGps2F8MppLim">--</span></div>
          </div>
        </div>
      </div>
    </div>

    <!-- ───── CAN ───── -->
    <div class="page" id="pg-can">
      <h2>CAN · 总线监控</h2>
      <div class="stat-grid">
        <div class="scard"><div class="snum"><span id="cRx">--</span></div><div class="slbl">接收帧</div></div>
        <div class="scard"><div class="snum"><span id="cMod">--</span></div><div class="slbl">改写帧</div></div>
        <div class="scard"><div class="snum"><span id="cErr">--</span></div><div class="slbl">错误</div></div>
        <div class="scard"><div class="snum"><span id="cRate">--</span><span class="sunit">Hz</span></div><div class="slbl">速率</div></div>
      </div>
      <div class="panel">
        <div class="ptitle">状态</div>
        <div class="info-grid">
          <div class="info-item"><div class="info-lbl">CAN 控制器</div><div class="info-val" id="cOK">--</div></div>
          <div class="info-item"><div class="info-lbl">硬件检测</div><div class="info-val" id="cHw">--</div></div>
          <div class="info-item"><div class="info-lbl">FSD 触发</div><div class="info-val" id="cFsd">--</div></div>
          <div class="info-item"><div class="info-lbl">安全模式</div><div class="info-val" id="cSafe">--</div></div>
        </div>
      </div>
      <div class="actions">
        <button class="abtn gray" onclick="openPhone()">📱 打开手机版</button>
      </div>
    </div>

    <!-- ───── 网络 ───── -->
    <div class="page" id="pg-net">
      <h2>网络 · NETWORK</h2>
      <div class="panel">
        <div class="ptitle">热点信息</div>
        <div class="info-grid">
          <div class="info-item"><div class="info-lbl">AP SSID</div><div class="info-val" id="nAp">--</div></div>
          <div class="info-item"><div class="info-lbl">AP IP</div><div class="info-val">9.9.9.9</div></div>
          <div class="info-item"><div class="info-lbl">上联热点</div><div class="info-val" id="nSta">--</div></div>
          <div class="info-item"><div class="info-lbl">上联 IP</div><div class="info-val" id="nStaIp">--</div></div>
        </div>
      </div>
      <div class="panel" id="panelBridge">
        <div class="ptitle">WiFi 桥接（上联互联网）</div>
        <div class="row"><div class="rlbl">启用桥接</div><div class="tog" id="tgBrEn"></div><div class="rval" id="brEnMode">关闭</div></div>
        <div class="info-grid">
          <div class="info-item"><div class="info-lbl">状态</div><div class="info-val" id="brStat">--</div></div>
          <div class="info-item"><div class="info-lbl">当前连接</div><div class="info-val" id="brSsid">--</div></div>
          <div class="info-item"><div class="info-lbl">NAT</div><div class="info-val" id="brNat">--</div></div>
          <div class="info-item"><div class="info-lbl">信号/温度</div><div class="info-val" id="brRssi">--</div></div>
        </div>
        <div style="margin-top:16px">
          <div style="font-size:16px;color:#a0a0a0;margin-bottom:8px">已保存热点</div>
          <div id="brList" style="font-size:17px;line-height:1.9;color:#e5e5e5">--</div>
        </div>
        <div style="margin-top:18px;padding-top:16px;border-top:1px solid #222">
          <div style="font-size:16px;color:#a0a0a0;margin-bottom:10px">添加热点</div>
          <div style="display:flex;gap:10px;flex-wrap:wrap">
            <input id="brAddSsid" placeholder="SSID"
              style="flex:1;min-width:220px;height:52px;padding:0 14px;background:rgba(255,255,255,.06);color:#fff;border:0;border-radius:10px;font-size:18px">
            <input id="brAddPass" type="password" placeholder="密码 (开放网络留空)"
              style="flex:1;min-width:220px;height:52px;padding:0 14px;background:rgba(255,255,255,.06);color:#fff;border:0;border-radius:10px;font-size:18px">
            <button class="abtn blue" onclick="brAdd()" style="min-width:130px">➕ 添加</button>
          </div>
          <div id="brAddMsg" class="tip" style="margin-top:8px;display:none"></div>
        </div>
      </div>
      <div class="actions">
        <button class="abtn gray" onclick="openPhone()">📱 打开手机版配置</button>
      </div>
    </div>

    <!-- ───── DNS ───── -->
    <div class="page" id="pg-dns">
      <h2>DNS 过滤 · DNS FILTER</h2>
      <div class="panel">
        <div class="ptitle">过滤状态</div>
        <div class="row"><div class="rlbl">启用过滤</div><div class="tog" id="tgDns"></div><div class="rval" id="dnsMode">关闭</div></div>
      </div>
      <div class="panel">
        <div class="ptitle">快捷预设</div>
        <div id="dnsPresetStat" style="margin-bottom:12px;font-size:15px;color:#a0a0a0">--</div>
        <div class="bgroup" id="grpDnsPreset" style="flex-direction:column;gap:14px">
          <button class="pill" id="pstTesla" style="flex:0 0 72px" onclick="dnsPreset('tesla_min')">⭐ Tesla 推荐（实测）</button>
          <button class="pill" id="pstLean"  style="flex:0 0 72px" onclick="dnsPreset('tesla_lean')">🔹 精简官方</button>
          <button class="pill" id="pstBl"    style="flex:0 0 72px" onclick="dnsPreset('bl_telemetry')">只屏蔽遥测</button>
          <button class="pill" id="pstClr"   style="flex:0 0 72px" onclick="dnsPreset('clear')">清空所有规则</button>
        </div>
        <div class="tip" style="margin-top:14px">🛈 自定义域名列表请点下方「📱 打开手机版」编辑。点上方预设会覆盖自定义规则。</div>
      </div>
      <div class="panel" id="panelDnsBlk">
        <div class="ptitle">最近拦截 <span style="color:#8a8a8a;font-size:13px;font-weight:500">总计 <span id="brBlkTot">0</span> 次</span></div>
        <div id="brBlkList" style="font-size:17px;line-height:1.9;color:#e5e5e5">--</div>
      </div>
      <div class="panel" id="panelIpStats">
        <div class="ptitle">IP 拦截缓存</div>
        <div class="row" style="margin-bottom:10px">
          <div class="rlbl">IP 层拦截开关</div>
          <div class="bgroup" id="grpIpBlk">
            <button class="pill" data-v="0" onclick="setIpBlk(0)">关</button>
            <button class="pill" data-v="1" onclick="setIpBlk(1)">开</button>
          </div>
        </div>
        <div class="tip" style="margin-bottom:10px">关闭可消除每包转发层开销，流媒体更流畅；开启才会按黑名单解析出的 IP 拦截。</div>
        <div class="info-grid">
          <div class="info-item"><div class="info-lbl">已丢弃包</div><div class="info-val"><span id="brIpDrops">--</span></div></div>
          <div class="info-item"><div class="info-lbl">缓存条数</div><div class="info-val"><span id="brIpCache">--</span> / <span id="brIpCacheCap">--</span></div></div>
          <div class="info-item"><div class="info-lbl">峰值</div><div class="info-val"><span id="brIpPeak">--</span></div></div>
        </div>
      </div>
      <div class="actions">
        <button class="abtn gray" onclick="openPhone()">📱 打开手机版</button>
      </div>
    </div>

    <!-- ───── OTA ───── -->
    <div class="page" id="pg-ota">
      <h2>固件升级 · OTA</h2>
      <div class="panel">
        <div class="ptitle">当前版本</div>
        <div class="info-grid">
          <div class="info-item"><div class="info-lbl">固件版本</div><div class="info-val" id="oVer">--</div></div>
          <div class="info-item"><div class="info-lbl">变体</div><div class="info-val" id="oVar">--</div></div>
        </div>
        <div style="margin-top:18px;padding-top:16px;border-top:1px solid #222">
          <div style="font-size:16px;color:#a0a0a0;margin-bottom:10px">车机软件版本（建议填写）</div>
          <div style="display:flex;gap:10px;flex-wrap:wrap;align-items:center">
            <input id="carVerInput" placeholder="例如 2024.44.25.1" maxlength="32" autocomplete="off"
              style="flex:1;min-width:220px;height:52px;padding:0 14px;background:rgba(255,255,255,.06);color:#fff;border:0;border-radius:10px;font-size:18px">
            <button class="abtn gray" id="carVerSave" onclick="saveCarVer()" style="min-width:120px">💾 保存</button>
          </div>
          <div id="carVerMsg" style="font-size:14px;color:#64748b;margin-top:8px;min-height:18px"></div>
          <div class="tip" style="margin-top:8px">🛈 建议填写：上传诊断包时一起带上方便定位限速/激活问题。在车机 控制 → 软件 里能看到，不填不影响功能。</div>
        </div>
      </div>
      <div class="panel">
        <div class="ptitle">上传新固件</div>
        <div class="ota-zone" id="otaZone">
          <div class="ota-tip">点击下方按钮选择固件 .bin 文件</div>
          <div class="ota-fname" id="otaFname">（未选择）</div>
          <div class="actions" style="margin-top:10px">
            <button class="abtn gray" onclick="otaPick()">📁 选择文件</button>
            <button class="abtn blue" id="otaUp" onclick="showOtaConfirm()" disabled style="opacity:.5">⬆️ 开始升级</button>
          </div>
          <div id="otaConfirmBox" style="display:none;background:#0a0a0a;border:2px solid #f59e0b;border-radius:12px;padding:16px;margin-top:14px;color:#fcd34d">
            <div style="font-size:18px;font-weight:700;margin-bottom:8px">⚠️ 确认刷入 <span id="otaConfirmName" style="font-family:monospace;color:#fbbf24">--</span>？</div>
            <div style="font-size:15px;margin-bottom:12px;color:#fca5a5">升级期间请勿断电或切换页面。</div>
            <div class="actions" style="margin-top:0">
              <button class="abtn" style="background:#dc2626" onclick="otaUpload()">✓ 确认升级</button>
              <button class="abtn gray" onclick="hideOtaConfirm()">取消</button>
            </div>
          </div>
        </div>
        <div class="progress" id="progBox"><div class="progress-bar" id="progBar" style="width:0%"></div></div>
        <div class="tip">🛈 升级过程中请勿断电或关闭页面。升级成功后模块将自动重启。</div>
        <input type="file" id="otaFile" accept=".bin" style="display:none">
      </div>
      <div class="panel">
        <div class="ptitle">在线更新（GitHub）</div>
        <div class="info-grid">
          <div class="info-item"><div class="info-lbl">当前</div><div class="info-val" id="otaCur">--</div></div>
          <div class="info-item"><div class="info-lbl">最新</div><div class="info-val" id="otaLat">--</div></div>
          <div class="info-item"><div class="info-lbl">变体</div><div class="info-val" id="otaEnv">--</div></div>
        </div>
        <div class="actions" style="margin-top:14px">
          <button class="abtn blue" id="otaChkBtn" onclick="otaCheck()">🔍 检查更新</button>
          <button class="abtn" id="otaPullBtn" onclick="otaPull()" disabled style="opacity:.5">⬇️ 下载并安装</button>
        </div>
        <div class="actions" style="margin-top:8px;display:none" id="carOtaNotesRow">
          <button class="abtn" id="carOtaNotesBtn" onclick="carShowOtaNotes()" style="background:#0e7490;width:100%">📋 查看更新内容</button>
        </div>
        <div class="progress" id="otaDlBox" style="display:none;margin-top:14px"><div class="progress-bar" id="otaDlBar" style="width:0%"></div></div>
        <div id="otaOnlineMsg" style="margin-top:10px;font-size:15px;color:#a0a0a0;min-height:22px"></div>
        <div class="tip">🛈 需连接路由器（网络页 STA）才能联网检查和下载。国内访问 GitHub 慢时自动经 gh-proxy.com 加速，镜像失败自动回退直连。</div>
      </div>
      <div class="panel" id="carRollbackPanel" style="display:none">
        <div class="ptitle">回滚到上一版</div>
        <div class="info-grid">
          <div class="info-item"><div class="info-lbl">上一版</div><div class="info-val" id="carOtaPrev">--</div></div>
        </div>
        <div class="actions" style="margin-top:14px">
          <button class="abtn" id="carRollbackBtn" onclick="carDoRollback()" style="background:#7c3aed">↩️ 回滚到上一版并重启</button>
        </div>
        <div id="carRollbackMsg" style="margin-top:10px;font-size:15px;color:#a0a0a0;min-height:22px"></div>
        <div class="tip">🛈 回滚会切换到另一个 OTA 分区。仅在设备曾通过 OTA 升级过一次后可用。</div>
      </div>
    </div>

    <!-- ───── 测速 ───── -->
    <div class="page" id="pg-perf">
      <h2>性能测试 · PERFORMANCE</h2>

      <div class="perf-disc" id="perfDisc">
        <div class="perf-disc-t">⚠️ 使用前须知</div>
        <div class="perf-disc-b">
          · 本测试<b>仅限封闭道路或专用场地</b>使用<br>
          · <b>严禁在公共道路、交通区域进行</b><br>
          · 测试结果受路面、坡度、温度等影响，<b>数据仅供参考</b>（精度 ±0.1 秒）<br>
          · 请确保测试区域安全，无行人及障碍物 · 所有风险由使用者自行承担
        </div>
        <button class="perf-disc-btn" onclick="perfDiscOk()">我已了解，在封闭场地使用</button>
      </div>

      <div class="perf-speed">
        <div class="perf-speed-val" id="perfSpd">--</div>
        <div class="perf-speed-lbl">KM/H</div>
      </div>

      <div class="perf-card" id="perfCardA">
        <div class="perf-head">
          <div class="perf-title">0 → 100 km/h</div>
          <span class="perf-badge idle" id="perfBadgeA">待命</span>
        </div>
        <div class="perf-bar"><div class="perf-fill accel" id="perfBarA"></div></div>
        <div class="perf-result">
          <span class="perf-val" id="perfValA">--</span>
          <span class="perf-unit" id="perfUnitA"></span>
        </div>
        <div class="perf-actions">
          <button class="perf-arm" id="perfArmA" onclick="perfArm('accel')">预 备</button>
          <button class="perf-reset" onclick="perfReset('accel')">重置</button>
        </div>
      </div>

      <div class="perf-card" id="perfCardB">
        <div class="perf-head">
          <div class="perf-title">100 → 0 km/h</div>
          <span class="perf-badge idle" id="perfBadgeB">待命</span>
        </div>
        <div class="perf-bar"><div class="perf-fill brake" id="perfBarB"></div></div>
        <div class="perf-result">
          <span class="perf-val" id="perfValB">--</span>
          <span class="perf-unit" id="perfUnitB"></span>
          <span class="perf-entry" id="perfEntryB" style="display:none"></span>
        </div>
        <div class="perf-actions">
          <button class="perf-arm" id="perfArmB" onclick="perfArm('brake')">预 备</button>
          <button class="perf-reset" onclick="perfReset('brake')">重置</button>
        </div>
      </div>

      <div class="perf-note">精度约 ±0.1 秒（受 CAN 10Hz 帧率限制）· 仅供参考 · 请在安全场地使用</div>

      <div class="perf-hist-head">
        <span class="perf-hist-t">0→100 历史</span>
        <button class="perf-hist-clr" onclick="perfClear('accel')">清除</button>
      </div>
      <div id="perfHistA"></div>

      <div class="perf-hist-head">
        <span class="perf-hist-t">100→0 历史</span>
        <button class="perf-hist-clr" onclick="perfClear('brake')">清除</button>
      </div>
      <div id="perfHistB"></div>
    </div>

    <!-- ───── 日志 ───── -->
    <div class="page" id="pg-log">
      <h2>诊断日志 · LOG</h2>
      <div class="panel">
        <div class="ptitle">事件日志 <span style="color:#8a8a8a;font-size:13px;font-weight:500">掉电清除 · 最近 80 条</span></div>
        <textarea id="diagLog" readonly style="width:100%;height:460px;background:rgba(255,255,255,.03);color:#a0a0a0;border:0;border-radius:10px;padding:12px;font-size:15px;font-family:monospace;resize:none;box-sizing:border-box;line-height:1.5">(加载中...)</textarea>
        <div class="actions">
          <button class="abtn blue" onclick="logRefresh()">🔄 刷新</button>
          <button class="abtn" onclick="logCopy()">📋 复制</button>
          <button class="abtn gray" onclick="showLogClear()">🗑 清除</button>
        </div>
        <div id="logClearBox" style="display:none;background:#0a0a0a;border:2px solid #ef4444;border-radius:12px;padding:16px;margin-top:14px;color:#fca5a5">
          <div style="font-size:18px;font-weight:700;margin-bottom:12px">确认清除所有日志？</div>
          <div class="actions" style="margin-top:0">
            <button class="abtn red" onclick="logClear()">✓ 清除</button>
            <button class="abtn gray" onclick="hideLogClear()">取消</button>
          </div>
        </div>
        <div class="tip">🛈 日志下载持久版本请用手机版（车机浏览器不便保存文件）</div>
      </div>
      <div class="panel" id="diagUpPanel" style="display:none">
        <div class="ptitle">上报诊断包</div>
        <div class="tip" style="margin-bottom:10px">
          🛈 一键打包当前模块状态（CAN 帧 ID 指纹、车型/HW 配置、限速/挡位/BMS 等）+ 最近 80 条日志，
          上传到项目服务器，生成一个 6 位 ID。把 ID 贴到 GitHub Issue 即可，
          内容只有维护者能解开（不公开）。<b>不包含位置 / VIN / 网络密码</b>。
        </div>
        <div style="display:flex;gap:10px;flex-wrap:wrap;align-items:center">
          <button class="abtn blue" id="diagUpBtn" onclick="diagUpload()" style="min-width:160px">📤 上传诊断包</button>
          <span id="diagUpId" style="display:none;font-family:monospace;font-size:24px;font-weight:700;color:#22c55e;letter-spacing:2px"></span>
          <button class="abtn gray" id="diagUpCopy" onclick="diagCopyId()" style="display:none">📋 复制 ID</button>
        </div>
        <div id="diagUpMsg" style="font-size:14px;color:#a0a0a0;margin-top:10px;min-height:18px"></div>
      </div>
    </div>

    <!-- ───── 设置 ───── -->
    <div class="page" id="pg-set">
      <h2>设置 · SETTINGS</h2>
      <div class="panel">
        <div class="ptitle">系统信息</div>
        <div class="info-grid">
          <div class="info-item"><div class="info-lbl">固件版本</div><div class="info-val" id="sVer">--</div></div>
          <div class="info-item"><div class="info-lbl">变体</div><div class="info-val" id="sVar">--</div></div>
          <div class="info-item"><div class="info-lbl">运行时间</div><div class="info-val" id="sUp">--</div></div>
          <div class="info-item"><div class="info-lbl">可用内存</div><div class="info-val" id="sHeap">--</div></div>
        </div>
      </div>
      <div class="panel">
        <div class="ptitle">操作</div>
        <div class="actions" style="margin-top:0">
          <button class="abtn blue" onclick="showRebootConfirm()">🔄 重启模块</button>
          <button class="abtn gray" onclick="openPhone()">📱 打开手机版</button>
        </div>
        <div id="rebootConfirmBox" style="display:none;background:#0a0a0a;border:2px solid #f59e0b;border-radius:12px;padding:16px;margin-top:14px;color:#fcd34d">
          <div style="font-size:18px;font-weight:700;margin-bottom:12px">确认重启模块？</div>
          <div class="actions" style="margin-top:0">
            <button class="abtn blue" onclick="doReboot()">✓ 确认重启</button>
            <button class="abtn gray" onclick="hideRebootConfirm()">取消</button>
          </div>
        </div>
        <div class="actions">
          <button class="abtn red" onclick="showFactoryConfirm()">⚠️ 恢复出厂</button>
        </div>
        <div id="factoryConfirmBox" style="display:none;background:#450a0a;border:2px solid #dc2626;border-radius:12px;padding:16px;margin-top:14px;color:#fca5a5">
          <div style="font-size:18px;font-weight:700;margin-bottom:8px">⚠️ 确认恢复出厂？</div>
          <div style="font-size:15px;margin-bottom:12px">将清空所有配置：热点 / 密码 / DNS / 速度偏移 / 智能规则 / PIN 等。此操作不可撤销。</div>
          <div class="actions" style="margin-top:0">
            <button class="abtn red" onclick="doFactory()">✓ 确认恢复出厂</button>
            <button class="abtn gray" onclick="hideFactoryConfirm()">取消</button>
          </div>
        </div>
        <div class="tip">⚠️ 恢复出厂会清空所有配置（热点/密码/DNS/速度偏移等），请谨慎操作。</div>
      </div>
    </div>

  </div>
</div>

<div class="toast" id="toast"></div>

<!-- PIN 验证弹窗 -->
<div class="pin-overlay" id="pinOv">
  <div class="pin-box">
    <h3>🔒 输入访问密码</h3>
    <input type="password" id="pinInput" maxlength="16">
    <div class="pin-err" id="pinErr"></div>
    <div class="actions" style="margin-top:20px">
      <button class="abtn blue" onclick="submitPin()">确认</button>
    </div>
  </div>
</div>

<!-- OTA Release Notes 弹窗 -->
<div id="carOtaNotesOverlay" style="display:none;position:fixed;inset:0;background:rgba(0,0,0,0.85);z-index:1500;align-items:center;justify-content:center;padding:24px;box-sizing:border-box" onclick="carHideOtaNotes(event)">
  <div style="background:#0a0a0a;border:1px solid #333;border-radius:14px;max-width:680px;width:100%;max-height:86vh;display:flex;flex-direction:column" onclick="event.stopPropagation()">
    <div style="padding:18px 22px;border-bottom:1px solid #222;display:flex;align-items:center;justify-content:space-between">
      <div style="font-size:18px;font-weight:600;color:#fff" id="carOtaNotesTitle">更新内容</div>
      <button onclick="carHideOtaNotes()" style="background:none;border:none;color:#888;font-size:28px;cursor:pointer;padding:0 6px;line-height:1">×</button>
    </div>
    <div id="carOtaNotesBody" style="padding:18px 22px;overflow-y:auto;color:#ccc;font-size:15px;line-height:1.7;flex:1"></div>
    <div class="actions" style="padding:14px 22px;border-top:1px solid #222">
      <button class="abtn" onclick="carHideOtaNotes()" style="flex:1">关闭</button>
      <button class="abtn blue" id="carOtaNotesInstallBtn" onclick="carHideOtaNotes();otaPull()" style="flex:1">⬇️ 下载并安装</button>
    </div>
  </div>
</div>

<script>
var tok = sessionStorage.getItem('fsd_tok') || '';
var pollT = null;
var last = null;

// ───── 导航 ─────
function applyNavForPage(p){
  var app = document.querySelector('.app');
  // 仪表盘：导航变窄图标栏；其他页：全宽导航
  if(p === 'dash'){ app.classList.add('nav-collapsed'); }
  else { app.classList.remove('nav-collapsed'); }
}
document.querySelectorAll('.nbtn').forEach(function(b){
  b.onclick = function(){
    document.querySelectorAll('.nbtn').forEach(function(x){x.classList.remove('active')});
    b.classList.add('active');
    var p = b.dataset.page;
    document.querySelectorAll('.page').forEach(function(x){x.classList.remove('show')});
    document.getElementById('pg-'+p).classList.add('show');
    applyNavForPage(p);
    if(p === 'log'){ logRefresh(); diagPoll(); }
    if(p === 'ota'){
      fetch('/api/ota/status'+(tok?'?token='+encodeURIComponent(tok):''))
        .then(function(r){ return r.ok?r.json():null; })
        .then(function(j){ if(j) otaRenderOnline(j); })
        .catch(function(){});
      carLoadPartInfo();
    }
  };
});
// 初始启动：默认在仪表盘 → 收起导航
applyNavForPage('dash');

// ───── 速度平滑插值（60fps, 与轮询解耦） ─────
window.__spdDisplay = 0; window.__spdTarget = 0; window.__spdLast = 0;
(function smoothSpeed(){
  var t = window.__spdTarget || 0;
  var v = window.__spdDisplay || 0;
  var diff = t - v;
  if(Math.abs(diff) > 0.4){ v += diff * 0.45; }
  else { v = t; }
  window.__spdDisplay = v;
  var show = Math.round(v);
  var el = document.getElementById('vSpeed');
  if(el && el.textContent !== String(show)) el.textContent = show;
  if(el){
    var big3 = show >= 100;
    if(big3 !== !!window.__big3){ el.classList.toggle('big3', big3); window.__big3 = big3; }
  }
  var arcFill = document.getElementById('arcFill');
  if(arcFill){
    var pct = Math.min(1, Math.max(0, v/200));
    arcFill.setAttribute('stroke-dasharray', (212.06 * pct).toFixed(1) + ' 283');
  }
  var cl = document.querySelector('.cluster');
  if(cl){
    var drv = v >= 3;
    if(drv !== !!window.__drv){ cl.classList.toggle('driving', drv); window.__drv = drv; }
    var warn = v >= 150;
    if(warn !== !!window.__warn){ cl.classList.toggle('warn', warn); window.__warn = warn; }
  }
  // 测速页速度：复用同一 RAF 平滑值
  var pEl = document.getElementById('perfSpd');
  if(pEl){
    var pShow = show > 0 ? String(show) : '--';
    if(pEl.textContent !== pShow) pEl.textContent = pShow;
    var pCls = 'perf-speed-val' + (show >= 100 ? ' red' : show >= 60 ? ' amber' : '');
    if(pEl.className !== pCls) pEl.className = pCls;
  }
  requestAnimationFrame(smoothSpeed);
})();

// ───── Toast ─────
function toast(msg, kind, duration){
  var t = document.getElementById('toast');
  t.textContent = msg;
  t.className = 'toast show ' + (kind||'');
  clearTimeout(t._timer);
  t._timer = setTimeout(function(){t.className='toast'}, duration||2200);
}

// ───── PIN ─────
function showPin(){document.getElementById('pinOv').classList.add('show');setTimeout(function(){document.getElementById('pinInput').focus()},100)}
function hidePin(){document.getElementById('pinOv').classList.remove('show');document.getElementById('pinInput').value='';document.getElementById('pinErr').textContent=''}
function submitPin(){
  var pin = document.getElementById('pinInput').value;
  if(!pin){document.getElementById('pinErr').textContent='请输入密码';return;}
  var fd = new FormData(); fd.append('pin', pin);
  fetch('/api/auth',{method:'POST',body:fd}).then(function(r){return r.text().then(function(t){return {s:r.status,t:t}})})
    .then(function(res){
      if(res.s===200 && res.t){
        sessionStorage.setItem('fsd_tok', res.t);
        tok = res.t;
        hidePin();
        poll();
      } else {
        document.getElementById('pinErr').textContent='密码错误';
      }
    });
}
document.getElementById('pinInput').addEventListener('keydown', function(e){if(e.key==='Enter')submitPin()});

// ───── 状态轮询 ─────
function authSuffix(){return tok ? '?token='+encodeURIComponent(tok) : ''}
// ───── 适配器：car UI 用 inline style.color，token 名是 `tok` ─────
function _DIAG_LITERALS(){return {
  upload:'📤 上传诊断包', retry:'📤 重试', retryAgain:'📤 重新上传',
  uploading:'⏳ 上传中…', inProg:'正在打包并上传…',
  done:'✓ 已生成 ID — 把它贴到 GitHub Issue 即可',
  reqFail:'请求失败', netErr:'网络错误',
  copied:'✓ 已复制 ', notSupported:'此固件变体不支持',
  carVerOK:'✓ 已保存', carVerFail:'✗ 保存失败',
  carVerSaving:'保存中...', carVerNetErr:'✗ 网络错误',
  carVerBadFmt:'⚠ 格式应为 2024.32.25 或 2024.32.25.1（年.周.补丁[.子号]），仍可保存'
};}
function _DIAG_STYLE(el,kind){
  if(!el) return;
  var c = kind==='ok' ? '#22c55e'
        : kind==='err' ? '#ef4444'
        : kind==='pending' ? '#64748b'
        : '#a0a0a0';
  el.style.color = kind ? c : '';
}
function _AUTH_TOKEN(){return tok||'';}
// Phone UI exposes diagPoll(); car UI used to call it the same way.
// Keep that alias so the rest of the page can call diagPoll().
function diagPoll(){ diagPollOnce(); }
)rawliteral"
DIAG_SHARED_JS
R"rawliteral(
function poll(){
  fetch('/api/status'+authSuffix())
    .then(function(r){
      if(r.status===403){showPin();return null}
      return r.json();
    })
    .then(function(d){
      if(!d) return;
      last = d;
      render(d);
      // if pinRequired and no token, prompt
      if(d.pinRequired && !tok) showPin();
    })
    .catch(function(){/* ignore */});
}

// ───── 渲染 ─────
var GEARS = {1:'P',2:'R',3:'N',4:'D'};
function fmtUptime(s){
  var h = Math.floor(s/3600), m = Math.floor((s%3600)/60), ss = s%60;
  if(h>0) return h+'h '+m+'m';
  if(m>0) return m+'m '+ss+'s';
  return ss+'s';
}
function setStat(id, ok, txt){
  var el = document.getElementById(id);
  el.className = 'hs ' + (ok?'ok':'err');
  document.getElementById(id+'Txt').textContent = txt;
}

function render(d){
  // 默认 AP 密码警告
  var pw=document.getElementById('passWarn');
  if(pw) pw.style.display = d.apPassDefault ? '' : 'none';
  // 顶栏
  setStat('hsCAN', d.canOK, 'CAN ' + (d.canOK?'已连接':'断开'));
  setStat('hsWifi', d.staOK, 'Wi-Fi ' + (d.staOK ? (d.staIP||'OK') : '仅热点'));
  // 顶栏温度显示芯片温度（所有固件都有）；车内温度在仪表盘 chips 行单独展示
  var hsTempEl = document.getElementById('hsTempTxt');
  if(d.chipTempC!==null && d.chipTempC!==undefined){
    hsTempEl.textContent = d.chipTempC.toFixed(0)+'°C';
    var lvl = d.thermalLevel||0;
    hsTempEl.style.color = lvl===0?'':(lvl===1?'#fbbf24':lvl===2?'#fb923c':'#ef4444');
  } else {
    hsTempEl.textContent = '--';
    hsTempEl.style.color = '';
  }
  document.getElementById('hsHeapTxt').textContent = Math.round(d.freeHeap/1024)+'KB';

  // ── 仪表盘 ──
  // 速度：仅设置目标值；RAF 循环负责平滑过渡
  var spd = Math.round(d.speedD / 10);
  var newSpd = (d.canOK && isFinite(spd)) ? spd : 0;
  var spdEl = document.getElementById('vSpeed');
  window.__spdTarget = newSpd;
  if(Math.abs(newSpd - (window.__spdLast||0)) >= 3){
    spdEl.classList.remove('tick'); void spdEl.offsetWidth; spdEl.classList.add('tick');
  }
  window.__spdLast = newSpd;
  // fusedLimit/visionLimit 原始 5-bit，×5 得 km/h
  var fusedKmh = (d.fusedLimit>0 && d.fusedLimit<31) ? d.fusedLimit*5
               : (d.visionLimit>0 && d.visionLimit<31 ? d.visionLimit*5 : 0);
  var offKmh = 0, offPctTxt = '', offShow = false;
  if(d.hwMode === 2){
    // HW4：离散档，与限速无关，只要非零就显示
    offKmh = hw4RawToKph(d.hw4Offset);
    offPctTxt = 'HW4';
    offShow = offKmh > 0;
  } else if(fusedKmh > 0){
    // HW3/Legacy：显示 Tesla 原车偏移百分比（从 mux-0 解码的 hw3AutoOffset）
    var offPct = d.hw3AutoOffset >= 0 ? d.hw3AutoOffset : 0;
    offKmh = Math.round(fusedKmh * offPct / 100);
    offPctTxt = (offPct > 0 ? '+' : '') + offPct + '%';
    offShow = offKmh > 0;
  }
  var spdOff = document.getElementById('spdOff');
  if(offShow){
    document.getElementById('vOffset').textContent = offKmh;
    document.getElementById('vOffsetPct').textContent = offPctTxt;
  }
  spdOff.classList.toggle('hide', !offShow);
  // SOC：仅 bmsSeen 时显示
  var socMini = document.getElementById('socMini');
  var socFill = document.getElementById('socFill');
  if(d.bmsSeen){
    var socPct = d.bmsSoc / 10;
    document.getElementById('vSoc').textContent = socPct.toFixed(0);
    socFill.style.width = socPct + '%';
    socFill.classList.remove('low','crit');
    var vSocWrap = document.getElementById('vSocWrap');
    if(vSocWrap) vSocWrap.classList.remove('low','crit');
    if(socPct < 10){ socFill.classList.add('crit'); if(vSocWrap) vSocWrap.classList.add('crit'); }
    else if(socPct < 25){ socFill.classList.add('low'); if(vSocWrap) vSocWrap.classList.add('low'); }
  }
  socMini.classList.toggle('hide', !d.bmsSeen);
  // 电池温度
  var miBmsT = document.getElementById('miBmsT');
  if(d.bmsSeen) document.getElementById('vBmsT').textContent = d.bmsMaxT;
  miBmsT.classList.toggle('hide', !d.bmsSeen);
  // 限速牌：无数据隐藏
  var lim = document.getElementById('limitSign');
  if(fusedKmh > 0){
    document.getElementById('vFused').textContent = fusedKmh;
    var usingVision = !(d.fusedLimit>0 && d.fusedLimit<31) && (d.visionLimit>0 && d.visionLimit<31);
    document.getElementById('vFusedSrc').innerHTML = usingVision ? '视觉识别' : '&nbsp;';
    // 限速变化时短促 pulse 一次（用 window.__prevLim 保证全局唯一态）
    if(fusedKmh !== window.__prevLim){
      var box = lim.querySelector('.limit-sign');
      if(box){ box.classList.remove('pulse'); void box.offsetWidth; box.classList.add('pulse'); }
      window.__prevLim = fusedKmh;
    }
  }
  lim.classList.toggle('hide', !(fusedKmh > 0));
  // 挡位：未知隐藏
  var gear = GEARS[d.gearRaw];
  var cGear = document.getElementById('cGear');
  var gbig = document.getElementById('gearBig');
  var apChip = document.getElementById('apChip');
  if(gear){
    // 换挡时触发弹出动画（隐藏后重新出现也要触发）
    if(gbig.textContent !== gear){
      gbig.textContent = gear;
      gbig.className = 'gear-big ' + gear;
      gbig.classList.remove('pop'); void gbig.offsetWidth; gbig.classList.add('pop');
    }
  } else {
    // 隐藏时清空，便于再次挂挡时触发 pop
    gbig.textContent = '';
  }
  cGear.classList.toggle('hide', !gear);
  // 自驾：仅 gwAutopilot>0（实际激活）且挡位可见时显示；0/NONE 或未感知直接隐藏
  var showAp = d.gwAutopilot > 0 && !!gear;
  if(showAp){
    var GWAP = ['NONE','HWY','EAP','FSD','BASIC'];
    document.getElementById('vGwAp').textContent = ' ' + (GWAP[d.gwAutopilot] || ('AP'+d.gwAutopilot));
    apChip.className = 'ap-mini fade-el on';
  }
  apChip.classList.toggle('hide', !showAp);
  // 运行时间：始终有
  document.getElementById('vUp').textContent = fmtUptime(d.uptime);
  document.getElementById('miUp').classList.remove('hide');
  // 车内/外温度
  if(d.tempSeen){
    var tIn = (d.tempInRaw*0.25).toFixed(1);
    var tOut = (d.tempOutRaw*0.5 - 40).toFixed(1);
    document.getElementById('vCabinTemp').textContent = tIn+' / '+tOut;
  }
  document.getElementById('rowCabinTemp').classList.toggle('hide', !d.tempSeen);
  // 芯片温度（thermalLevel: 0 normal / 1 warning / 2 throttled / 3 protect）
  var hasChip = d.chipTempC!=null;
  document.getElementById('rowChipTemp').classList.toggle('hide', !hasChip);
  if(hasChip){
    var s = d.chipTempC.toFixed(1)+'°C';
    if(d.thermalLevel>0 && d.thermalStatus) s += ' · '+d.thermalStatus;
    var ce = document.getElementById('vChipTemp');
    ce.textContent = s;
    var lvl = d.thermalLevel||0;
    ce.style.color = lvl===0?'':(lvl===1?'#fbbf24':lvl===2?'#fb923c':'#ef4444');
  }
  // 安全模式横幅
  document.getElementById('rowSafeMode').style.display = d.safeMode ? '' : 'none';

  // 控制页
  setTog('tgFsd', d.fsdEnable);
  // Server-authoritative sync: reset toggle + panel from poll on every tick so a failed
  // /api/set (network/403) doesn't leave the UI showing "custom on, panel hidden" forever.
  setTog('tgAuto', d.hw3AutoSpeed==null ? true : !!d.hw3AutoSpeed);
  setTog('tgCustom', !!d.hw3CustomSpeed);
  var rowCust = document.getElementById('rowHw3Custom');
  if(rowCust) rowCust.style.display = (d.hwMode===1 && d.hw3CustomSpeed) ? '' : 'none';
  if(Array.isArray(d.hw3CustomTarget)){
    for(var _i=0;_i<5;_i++){
      var _e=document.getElementById('hw3CT'+_i);
      var _v=(d.hw3CustomTarget[_i]!=null?Number(d.hw3CustomTarget[_i]):HW3CT_DEF[_i]);
      if(_e && !hw3CTDirty['hw3CT'+_i]) _e.textContent=_v;
    }
  }
  setTog('tgSlew', !!d.hw3OffsetSlew);
  var rowSlew = document.getElementById('rowHw3SlewDiag');
  if(rowSlew) rowSlew.style.display = (d.hwMode===1 && d.hw3OffsetSlew) ? '' : 'none';
  (function(){
    var cT=document.getElementById('cSlewTarget'); if(cT)cT.textContent=(d.hw3OffsetTarget!=null)?d.hw3OffsetTarget:'--';
    var cS=document.getElementById('cSlewSent');   if(cS)cS.textContent=(d.hw3OffsetLast!=null)?d.hw3OffsetLast:'--';
    var cC=document.getElementById('cSlewCount');  if(cC)cC.textContent=d.hw3SlewCount||0;
    var cR=document.getElementById('cSlewRate');
    var rv=(d.hw3SlewRate!=null?Number(d.hw3SlewRate):SLEW_DEF);
    if(cR && !slewDirty) cR.textContent=rv;
    var cK=document.getElementById('cSlewKphHint');
    if(cK) cK.textContent=fmtSlewKph(rv);
  })();
  setTog('tgHiSpd', !!d.hw3HighSpeedEnable);
  var rowHi = document.getElementById('rowHw3HiSpdPanel');
  if(rowHi) rowHi.style.display = (d.hwMode===1 && d.hw3HighSpeedEnable) ? '' : 'none';
  (function(){
    var hsArr=Array.isArray(d.hw3HighSpeedPct)?d.hw3HighSpeedPct:HW3HS_DEF;
    var hsLbl=[80,90,100,110,120];
    var parts=[];
    for(var i=0;i<5;i++){
      var p=(hsArr[i]!=null?Number(hsArr[i]):HW3HS_DEF[i]);
      var el=document.getElementById('hw3HsPct'+i);
      if(el && !hw3HSDirty['hw3HsPct'+i]) el.textContent=p;
      parts.push(hsLbl[i]+'→+'+Math.round(hsLbl[i]*p/100));
    }
    var cH=document.getElementById('cHiSpdHint');
    if(cH) cH.textContent='('+parts.join(' / ')+')';
  })();
  setTog('tgIsa', d.isaChime);
  setTog('tgIsaOvr', d.isaOverride);
  setTog('tgEmerg', d.emergencyDet);
  setTog('tgForce', d.forceActivate);
  setTog('tgTlssc', d.tlsscBypass);
  setTog('tgOvr', d.overrideSL);
  setTog('tgRvsl', d.removeVSL==null?true:!!d.removeVSL);
  (function(){var e=document.getElementById('cLegOff'); if(e && !legacyDirty) e.textContent=(d.legacyOffset!=null?Number(d.legacyOffset):LEGACY_DEF);})();
  (function(){
    var r=document.getElementById('rowGps2F8'); if(!r) return;
    r.style.display=(d.hwMode===0)?'':'none';
    if(d.hwMode!==0) return;
    var seen=document.getElementById('cGps2F8Seen');
    if(seen){ seen.textContent=d.gps2F8Seen?'YES':'no'; seen.style.color=d.gps2F8Seen?'#4ade80':'#f87171'; }
    document.getElementById('cGps2F8Count').textContent=d.gps2F8Count||0;
    document.getElementById('cGps2F8Period').textContent=(d.gps2F8Period||0)+' ms';
    var uo=(d.gps2F8UserOffRaw!=null?d.gps2F8UserOffRaw:0);
    document.getElementById('cGps2F8UserOff').textContent=uo+' (='+(uo-30)+' kph)';
    var ml=(d.gps2F8MppLimRaw!=null?d.gps2F8MppLimRaw:0);
    document.getElementById('cGps2F8MppLim').textContent=ml+' (='+(ml*5)+' kph)';
  })();
  // HW 选中
  document.querySelectorAll('#grpHw .pill').forEach(function(b){
    b.classList.toggle('active', parseInt(b.dataset.v)===d.hwMode);
  });
  // 速度模式 labels/可见 per hwMode（HW3/Legacy 3 档，HW4 5 档）
  var isHW3 = (d.hwMode===1), isHW4 = (d.hwMode===2), isLegacy = (d.hwMode===0);
  document.querySelectorAll('#grpSpd .pill').forEach(function(b){
    var sp = parseInt(b.dataset.sp);
    var lbl = isHW4 ? b.dataset.hw4 : b.dataset.hw3;
    if(lbl){ b.textContent = lbl; b.style.display = ''; }
    else   { b.style.display = 'none'; }
    b.classList.toggle('active', sp===d.speedProfile);
    b.classList.toggle('dis', !!d.profileMode);
  });
  document.querySelectorAll('#grpPMode .pill').forEach(function(b){
    b.classList.toggle('active', parseInt(b.dataset.pm)===d.profileMode);
  });

  // HW3/HW4 面板切换（0=Legacy, 1=HW3, 2=HW4）
  document.getElementById('panelHw3').style.display = isHW3 ? 'block' : 'none';
  document.getElementById('panelHw4').style.display = isHW4 ? 'block' : 'none';
  // 模式专属开关行
  document.getElementById('rowEmerg').style.display = isHW4 ? '' : 'none';
  document.getElementById('rowOvr').style.display = isLegacy ? '' : 'none';
  document.getElementById('rowRvsl').style.display = isLegacy ? '' : 'none';
  document.getElementById('rowLegOff').style.display = isLegacy ? '' : 'none';
  document.getElementById('rowTlssc').style.display = (isHW3||isHW4) ? '' : 'none';
  document.getElementById('tipTlssc').style.display = (isHW3||isHW4) ? '' : 'none';
  // HW4 偏移 stepper 值回填（respect dirty）
  (function(){
    var e=document.getElementById('cHw4Off'), k=document.getElementById('cHw4OffKmh');
    if(e && !hw4OffDirty){
      var v=(d.hw4Offset!=null)?Number(d.hw4Offset):HW4OFF_DEF;
      e.textContent=v;
      if(k) k.textContent=hw4RawToKph(v);
    }
  })();
  // HW3 编码 pill 选中
  var encCur = (d.hw3WireEncoding!=null)?parseInt(d.hw3WireEncoding):1;
  document.querySelectorAll('#grpHw3Enc .pill').forEach(function(b){
    b.classList.toggle('active', parseInt(b.dataset.enc)===encCur);
  });
  // IP 拦截开关 pill 选中
  var ipBlkCur = d.ipBlockerEnabled?1:0;
  document.querySelectorAll('#grpIpBlk .pill').forEach(function(b){
    b.classList.toggle('active', parseInt(b.dataset.v)===ipBlkCur);
  });

  // CAN 页
  document.getElementById('cRx').textContent = d.rx;
  document.getElementById('cMod').textContent = d.modified;
  document.getElementById('cErr').textContent = d.errors;
  // CAN 速率：按 rx 差值 / 时间差估算（客户端计算，后端不维护）
  var now = Date.now();
  if(window.__rxPrev !== undefined && window.__rxPrevT){
    var dt = (now - window.__rxPrevT) / 1000;
    var dr = d.rx - window.__rxPrev;
    if(dt > 0 && dr >= 0){
      var hz = Math.round(dr / dt);
      document.getElementById('cRate').textContent = hz;
    }
  } else {
    document.getElementById('cRate').textContent = '--';
  }
  window.__rxPrev = d.rx; window.__rxPrevT = now;
  document.getElementById('cOK').textContent = d.canOK ? '✅ OK' : '❌ FAIL';
  document.getElementById('cHw').textContent = ['未知','HW3','HW4'][d.hwDetected]||'未知';
  document.getElementById('cFsd').textContent = d.fsdTriggered ? '✅ 已触发' : '-';
  document.getElementById('cSafe').textContent = d.safeMode ? '⚠️ 安全模式' : '正常';

  // 网络页
  document.getElementById('nAp').textContent = d.apSSID||'--';
  document.getElementById('nSta').textContent = d.staSSID||'(未配置)';
  document.getElementById('nStaIp').textContent = d.staIP||'--';

  // 设置页
  document.getElementById('sVer').textContent = d.version + (d.variant?(' ('+d.variant+')'):'');
  document.getElementById('sVar').textContent = d.variant||'baseline';
  document.getElementById('sUp').textContent = fmtUptime(d.uptime);
  document.getElementById('sHeap').textContent = Math.round(d.freeHeap/1024)+' KB';

  // OTA 页
  document.getElementById('oVer').textContent = d.version;
  document.getElementById('oVar').textContent = d.variant||'baseline';
  var carVerEl=document.getElementById('carVerInput');
  if(carVerEl&&!carVerDirty&&typeof d.carSwVer==='string'&&carVerEl.value!==d.carSwVer)carVerEl.value=d.carSwVer;

  // 诊断包上传：仅 Wi-Fi 变体启用（需要 STA 联网才能 POST 到外部 Worker）
  var diagPanel=document.getElementById('diagUpPanel');
  if(diagPanel){
    var hasWifi = d.variant && d.variant.indexOf('Wi-Fi')>=0;
    diagPanel.style.display = hasWifi ? '' : 'none';
  }

  // 测速页：若加载了则同步状态
  perfRender(d);
}

// ───── 测速 ─────
var PERF_BADGE = ['idle','armed','running','done'];
var PERF_TXT = ['待命','已备战','计时中','完成'];
var perfPrev = {accel:-1, brake:-1};  // -1: 首次 poll 用当前值初始化，避免页面刷新时把已完成状态当新完成重复入库
var perfAnimDone = {accel:false, brake:false};
var perfBrakeEntry = 0;
function perfAck(){ try{ return sessionStorage.getItem('perf_disc_ok') === '1'; }catch(e){ return false; } }
function perfDiscOk(){
  try{ sessionStorage.setItem('perf_disc_ok','1'); }catch(e){}
  document.getElementById('perfDisc').style.display = 'none';
  // 恢复按钮可用（当前 state 若非 running/done）
  if(last) perfApplyState('accel', last.perfAccel||0, last.perfAccelMs||0, Math.round((last.speedD||0)/10));
  if(last) perfApplyState('brake', last.perfBrake||0, last.perfBrakeMs||0, Math.round((last.speedD||0)/10));
}
function perfCountUp(elId, targetSec, duration){
  var el = document.getElementById(elId);
  var start = performance.now();
  function step(now){
    var p = Math.min((now-start)/duration, 1);
    var e = 1 - Math.pow(1-p, 3);
    el.textContent = (targetSec*e).toFixed(2);
    if(p < 1) requestAnimationFrame(step);
    else el.textContent = targetSec.toFixed(2);
  }
  requestAnimationFrame(step);
}
function perfFlash(id){
  var c = document.getElementById(id);
  c.classList.add('done');
  setTimeout(function(){ c.classList.remove('done'); }, 1500);
}
function perfApplyState(which, state, ms, spd){
  var isA = (which === 'accel');
  var badge = document.getElementById(isA ? 'perfBadgeA' : 'perfBadgeB');
  var val = document.getElementById(isA ? 'perfValA' : 'perfValB');
  var unit = document.getElementById(isA ? 'perfUnitA' : 'perfUnitB');
  var bar = document.getElementById(isA ? 'perfBarA' : 'perfBarB');
  var arm = document.getElementById(isA ? 'perfArmA' : 'perfArmB');
  badge.className = 'perf-badge ' + (PERF_BADGE[state] || 'idle');
  badge.textContent = PERF_TXT[state] || '--';
  if(state === 2){
    var pct = 0;
    if(isA) pct = Math.min(spd, 100);
    else pct = Math.min(100, Math.max(0, perfBrakeEntry > 0 ? (1 - spd/perfBrakeEntry)*100 : 0));
    bar.style.width = pct + '%';
  } else if(state === 3){
    bar.style.width = '100%';
  } else {
    bar.style.width = '0%';
  }
  arm.disabled = (state === 2 || state === 3) || !perfAck();
  if(state === 3 && ms > 0){
    unit.textContent = '秒';
    if(!perfAnimDone[which]){
      perfCountUp(isA ? 'perfValA' : 'perfValB', ms/1000, 900);
      perfFlash(isA ? 'perfCardA' : 'perfCardB');
      perfAnimDone[which] = true;
      if(!isA){
        var et = document.getElementById('perfEntryB');
        if(perfBrakeEntry > 0){ et.textContent = '进入 ' + perfBrakeEntry + ' km/h'; et.style.display = ''; }
      }
    }
  } else if(state === 2){
    val.textContent = '...';
    unit.textContent = '';
  } else {
    val.textContent = '--';
    unit.textContent = '';
    perfAnimDone[which] = false;
    if(!isA) document.getElementById('perfEntryB').style.display = 'none';
  }
}
function perfRender(d){
  if(!d) return;
  var spd = Math.round((d.speedD||0)/10);
  perfBrakeEntry = d.brakeEntryKph || 0;
  var na = d.perfAccel||0, nb = d.perfBrake||0;
  // 首次 poll：用当前状态初始化 prev，避免页面刷新时对已有 DONE 状态重复入库
  if(perfPrev.accel === -1){
    perfPrev.accel = na;
    if(na === 3){ perfAnimDone.accel = true; }  // 跳过动画，避免刷新后弹结果
  }
  if(perfPrev.brake === -1){
    perfPrev.brake = nb;
    if(nb === 3){ perfAnimDone.brake = true; }
  }
  if(perfPrev.accel !== 3 && na === 3 && d.perfAccelMs > 0) perfSave('accel', d.perfAccelMs, 0);
  if(perfPrev.brake !== 3 && nb === 3 && d.perfBrakeMs > 0) perfSave('brake', d.perfBrakeMs, d.brakeEntryKph||0);
  perfApplyState('accel', na, d.perfAccelMs||0, spd);
  perfApplyState('brake', nb, d.perfBrakeMs||0, spd);
  perfPrev.accel = na; perfPrev.brake = nb;
  // 若已 DONE 且跳过了动画，把结果直接写上
  if(na === 3 && d.perfAccelMs > 0 && document.getElementById('perfValA').textContent === '--'){
    document.getElementById('perfValA').textContent = (d.perfAccelMs/1000).toFixed(2);
    document.getElementById('perfUnitA').textContent = '秒';
  }
  if(nb === 3 && d.perfBrakeMs > 0 && document.getElementById('perfValB').textContent === '--'){
    document.getElementById('perfValB').textContent = (d.perfBrakeMs/1000).toFixed(2);
    document.getElementById('perfUnitB').textContent = '秒';
    var et = document.getElementById('perfEntryB');
    if(perfBrakeEntry > 0){ et.textContent = '进入 '+perfBrakeEntry+' km/h'; et.style.display = ''; }
  }
}
function perfArm(which){
  if(!perfAck()){ toast('请先确认使用须知', 'err'); return; }
  fetch('/api/perf?cmd=arm_'+which+(tok?'&token='+encodeURIComponent(tok):''))
    .then(function(r){return r.json();}).then(function(){ poll(); });
}
function perfReset(which){
  perfAnimDone[which] = false;
  if(which === 'brake') document.getElementById('perfEntryB').style.display = 'none';
  fetch('/api/perf?cmd=reset_'+which+(tok?'&token='+encodeURIComponent(tok):''))
    .then(function(r){return r.json();}).then(function(){ poll(); });
}
function perfSave(type, ms, entry){
  var key = 'perf_hist_'+type;
  var arr = [];
  try{ arr = JSON.parse(localStorage.getItem(key)||'[]'); }catch(e){}
  arr.unshift({ts:Date.now(), ms:ms, entry:entry||0});
  if(arr.length > 10) arr = arr.slice(0, 10);
  try{ localStorage.setItem(key, JSON.stringify(arr)); }catch(e){}
  perfRenderHist(type);
}
function perfClear(type){
  try{ localStorage.removeItem('perf_hist_'+type); }catch(e){}
  perfRenderHist(type);
}
function perfFmtTs(ts){
  var d = new Date(ts);
  var p = function(n){ return n<10?'0'+n:''+n; };
  return p(d.getMonth()+1)+'/'+p(d.getDate())+' '+p(d.getHours())+':'+p(d.getMinutes())+':'+p(d.getSeconds());
}
function perfRenderHist(type){
  var listEl = document.getElementById(type==='accel' ? 'perfHistA' : 'perfHistB');
  if(!listEl) return;
  var arr = [];
  try{ arr = JSON.parse(localStorage.getItem('perf_hist_'+type)||'[]'); }catch(e){}
  if(arr.length === 0){ listEl.innerHTML = '<div class="perf-hist-empty">暂无记录</div>'; return; }
  var html = '';
  for(var i=0;i<arr.length;i++){
    var r = arr[i];
    html += '<div class="perf-hist-row '+type+'">';
    html += '<span class="perf-hist-ts">'+perfFmtTs(r.ts)+'</span>';
    html += '<span><span class="perf-hist-v">'+(r.ms/1000).toFixed(2)+'</span><span class="perf-hist-u">秒</span>';
    if(type === 'brake' && r.entry > 0) html += '<span class="perf-hist-e">进入 '+r.entry+' km/h</span>';
    html += '</span></div>';
  }
  listEl.innerHTML = html;
}
// 初始化：若本会话已确认过免责声明，隐藏
try{ if(sessionStorage.getItem('perf_disc_ok') === '1'){
  var _pd = document.getElementById('perfDisc'); if(_pd) _pd.style.display = 'none';
} }catch(e){}
perfRenderHist('accel');
perfRenderHist('brake');

function setTog(id, on){
  var t = document.getElementById(id);
  if(!t) return;
  t.classList.toggle('on', !!on);
}

// ───── 开关点击 ─────
// Turning a paired toggle on forces its sibling off. `panelOwner` is the key whose
// on-state reveals the shared panel (symmetrical data structure vs desktop UI).
var TOG_MUTEX = {
  hw3AutoSpeed:  {sib:{k:'hw3CustomSpeed',id:'tgCustom'}, panel:'rowHw3Custom', panelOwner:'hw3CustomSpeed'},
  hw3CustomSpeed:{sib:{k:'hw3AutoSpeed',  id:'tgAuto'},   panel:'rowHw3Custom', panelOwner:'hw3CustomSpeed'}
};
document.querySelectorAll('.tog[data-k]').forEach(function(t){
  t.onclick = function(){
    var k = t.dataset.k;
    var newVal = !t.classList.contains('on');
    t.classList.toggle('on', newVal);
    apiSet(k, newVal?1:0);
    var cfg = TOG_MUTEX[k];
    if(cfg){
      if(newVal){
        var s = document.getElementById(cfg.sib.id);
        if(s && s.classList.contains('on')){ s.classList.remove('on'); apiSet(cfg.sib.k, 0); }
      }
      // Panel shows iff panelOwner's toggle is ON (optimistic; poll() corrects on HTTP fail).
      var ownerOn = (k===cfg.panelOwner) ? newVal : false;  // sib toggle OFF forces panel hidden
      var panel = document.getElementById(cfg.panel);
      if(panel) panel.style.display = ownerOn ? '' : 'none';
    }
  };
});
// DNS 开关（单独，需要调 wifi-bridge API）
document.getElementById('tgDns').onclick = function(){
  var t = this;
  var newVal = !t.classList.contains('on');
  t.classList.toggle('on', newVal);
  document.getElementById('dnsMode').textContent = newVal?'启用':'关闭';
  var qs = '?dnsEnable='+(newVal?1:0) + (tok?'&token='+encodeURIComponent(tok):'');
  fetch('/api/wifi-bridge/set'+qs)
    .then(function(r){if(r.status===200){toast('DNS 过滤 '+(newVal?'已启用':'已关闭'), 'ok');brPoll();}else toast('失败','err')});
};
// 桥接启用开关（upstreamEnable）
document.getElementById('tgBrEn').onclick = function(){
  var t = this;
  var newVal = !t.classList.contains('on');
  t.classList.toggle('on', newVal);
  document.getElementById('brEnMode').textContent = newVal?'启用':'关闭';
  var qs = '?upstreamEnable='+(newVal?1:0) + (tok?'&token='+encodeURIComponent(tok):'');
  fetch('/api/wifi-bridge/set'+qs)
    .then(function(r){if(r.status===200){toast('WiFi 桥接 '+(newVal?'已启用':'已关闭'), 'ok');brPoll();}else toast('失败','err')});
};

// ───── WiFi 桥接 / DNS 状态轮询 ─────
function brPoll(){
  fetch('/api/wifi-bridge/status'+(tok?'?token='+encodeURIComponent(tok):'')).then(function(r){return r.ok?r.json():null;}).then(function(d){
    if(!d) return;
    document.getElementById('brStat').textContent = (d.upstreamStatus||'--')
      + (d.upstreamRSSI!==null && d.upstreamRSSI!==undefined ? ' · '+d.upstreamRSSI+' dBm' : '');
    document.getElementById('brSsid').textContent = d.upstreamSSID || '--';
    document.getElementById('brNat').textContent  = d.natStatus || '--';
    var t = '--';
    if(d.chipTempC!==null && d.chipTempC!==undefined){
      t = d.chipTempC.toFixed(1)+'°C';
      if(d.thermalStatus) t += ' · '+d.thermalStatus;
    }
    document.getElementById('brRssi').textContent = t;
    // 桥接启用开关同步
    var tgEn = document.getElementById('tgBrEn');
    tgEn.classList.toggle('on', !!d.upstreamEnable);
    document.getElementById('brEnMode').textContent = d.upstreamEnable ? '启用' : '关闭';
    // DNS 开关 & 文案
    var tg = document.getElementById('tgDns');
    tg.classList.toggle('on', !!d.dnsEnable);
    document.getElementById('dnsMode').textContent = d.dnsEnable ? '启用' : '关闭';
    // 已保存热点列表（可添加/删除，带内联确认）
    var list = document.getElementById('brList');
    var nets = d.upstreamNetworks || [];
    if(!nets.length){
      list.innerHTML = '<span style="color:#8a8a8a">无已保存热点</span>';
    } else {
      list.innerHTML = nets.map(function(n){
        var dot = n.connected ? '🟢' : (n.active ? '🟡' : '⚪');
        var pass = n.hasPass ? '' : ' <span style="color:#fbbf24;font-size:14px">(开放)</span>';
        var safeSsid = escHtml(n.ssid);
        var ssidAttr = n.ssid.replace(/&/g,'&amp;').replace(/"/g,'&quot;');
        return ''
          + '<div style="padding:6px 0;border-bottom:1px solid #222">'
          +   '<div style="display:flex;justify-content:space-between;align-items:center">'
          +     '<span>'+dot+' '+safeSsid+pass+'</span>'
          +     '<button class="abtn gray" style="min-width:84px;height:38px;font-size:15px" '
          +       'onclick="brDelConfirm(\''+ssidAttr+'\')">🗑 删除</button>'
          +   '</div>'
          +   '<div data-del-ssid="'+ssidAttr+'" style="display:none;margin-top:8px;padding:10px;background:#0a0a0a;border:2px solid #ef4444;border-radius:10px">'
          +     '<div style="color:#fca5a5;margin-bottom:8px">确认删除 <b>'+safeSsid+'</b>？</div>'
          +     '<div style="display:flex;gap:10px">'
          +       '<button class="abtn red" onclick="brDelDo(\''+ssidAttr+'\')">✓ 确认</button>'
          +       '<button class="abtn gray" onclick="brDelCancel(\''+ssidAttr+'\')">取消</button>'
          +     '</div>'
          +   '</div>'
          + '</div>';
      }).join('');
    }
    // 预设激活态
    highlightPreset(d.dnsAllow, d.dnsBlock);
    // IP 拦截缓存统计
    var setIp = function(id, v){ var el=document.getElementById(id); if(el) el.textContent = (v==null?'--':v); };
    setIp('brIpDrops',    d.ipBlockDrops);
    setIp('brIpCache',    d.ipCacheCount);
    setIp('brIpCacheCap', d.ipCacheCap);
    setIp('brIpPeak',     d.ipCachePeak);
    // 最近拦截
    document.getElementById('brBlkTot').textContent = d.dnsBlockedTotal || 0;
    var blk = d.dnsBlockedRecent || [];
    var blkEl = document.getElementById('brBlkList');
    if(!blk.length){
      blkEl.innerHTML = '<span style="color:#8a8a8a">暂无拦截</span>';
    } else {
      blkEl.innerHTML = blk.map(function(e){
        return '<div style="display:flex;justify-content:space-between;padding:3px 0;border-bottom:1px solid #222">'+
          '<span>'+escHtml(e.domain)+'</span><span style="color:#a0a0a0">×'+e.count+'</span></div>';
      }).join('');
    }
  }).catch(function(){});
}
function escHtml(s){ var d=document.createElement('div'); d.textContent=String(s==null?'':s); return d.innerHTML; }

// ───── HW 选择 ─────
document.querySelectorAll('#grpHw .pill').forEach(function(b){
  b.onclick = function(){apiSet('hwMode', b.dataset.v)};
});
// ───── 速度模式 / 模式来源 ─────
document.querySelectorAll('#grpSpd .pill').forEach(function(b){
  b.onclick = function(){
    if(last && last.profileMode) return; // 自动模式下 speedProfile 只读
    apiSet('speedProfile', b.dataset.sp);
  };
});
document.querySelectorAll('#grpPMode .pill').forEach(function(b){
  b.onclick = function(){apiSet('profileMode', b.dataset.pm)};
});
document.querySelectorAll('#grpHw3Enc .pill').forEach(function(b){
  b.onclick = function(){apiSet('hw3WireEncoding', b.dataset.enc)};
});

// ───── apiSet ─────
function apiSet(k, v){
  fetch('/api/set?'+k+'='+v+(tok?'&token='+encodeURIComponent(tok):''))
    .then(function(r){if(r.status===200){toast('已保存','ok');poll()}else if(r.status===403){showPin()}else{toast('失败','err')}});
}
// ───── ±stepper factory ─────
// debounce=coalesce rapid taps into one POST; settle=grace before poll overwrites dirty spans.
var STEP_DEBOUNCE_MS=400, STEP_SETTLE_MS=600;
var HW3CT_RANGE=[[30,45],[40,60],[50,75],[60,90],[70,105]];
var HW3CT_DEF=HW3CT_RANGE.map(function(r){return r[1];});
var HW3HS_DEF=[25,25,25,25,25];
var SLEW_DEF=5, LEGACY_DEF=0, HW4OFF_DEF=0;
// HW4 offset raw → km/h (~0.714 ratio, calibrated from legacy presets 7→5,10→7,14→10,15→11)
function hw4RawToKph(r){ return r>0 ? Math.round(r*5/7) : 0; }
var hw3CTDirty={}, hw3HSDirty={}, slewDirty=false, legacyDirty=false, hw4OffDirty=false;
function fmtSlewKph(rv){ return '≈ -'+(rv*0.6).toFixed(1)+' kph/s @60限速'; }

// idOf(idx)→DOM id, paramOf(id)→POST key (default identity), range(idx)→[min,max], def(idx)→seed,
// dirty=map object OR string 'slew' (uses module-scoped slewDirty flag).
function makeStepper(opts){
  var pending={}, debounce=null, settle=null;
  var paramOf=opts.paramOf||function(id){return id;};
  return function(idx, delta){
    var id=opts.idOf(idx);
    var el=document.getElementById(id); if(!el) return;
    var cur=parseInt(el.textContent,10); if(isNaN(cur)) cur=opts.def(idx);
    var rng=opts.range(idx), nv=cur+delta;
    if(nv<rng[0]) nv=rng[0]; if(nv>rng[1]) nv=rng[1];
    if(nv===cur) return;
    el.textContent=nv;
    if(opts.dirty==='slew') slewDirty=true;
    else if(opts.dirty==='legacy') legacyDirty=true;
    else if(opts.dirty==='hw4off') hw4OffDirty=true;
    else opts.dirty[id]=true;
    pending[id]=nv;
    if(opts.onChange) opts.onChange(nv);
    clearTimeout(debounce); clearTimeout(settle);  // kill in-flight settle so new save isn't nuked
    debounce=setTimeout(function(){
      var qs=''; for(var _id in pending){ qs+='&'+paramOf(_id)+'='+encodeURIComponent(pending[_id]); }
      var sent=pending; pending={};
      if(!qs) return;
      fetch('/api/set?'+qs.slice(1)+(tok?'&token='+encodeURIComponent(tok):''))
        .then(function(r){
          function clearDirty(){
            if(opts.dirty==='slew') slewDirty=false;
            else if(opts.dirty==='legacy') legacyDirty=false;
            else if(opts.dirty==='hw4off') hw4OffDirty=false;
            else for(var k in sent) delete opts.dirty[k];
          }
          if(r.status===200){
            toast('已保存','ok');
            settle=setTimeout(function(){ clearDirty(); poll(); }, STEP_SETTLE_MS);
          } else if(r.status===403){ showPin(); }
          else { toast('失败','err'); clearDirty(); }
        });
    }, STEP_DEBOUNCE_MS);
  };
}

var hw3CtStep=makeStepper({
  idOf:function(i){return 'hw3CT'+i;},
  range:function(i){return HW3CT_RANGE[i];},
  def:function(i){return HW3CT_DEF[i];},
  dirty:hw3CTDirty
});
var hw3HsStep=makeStepper({
  idOf:function(i){return 'hw3HsPct'+i;},
  range:function(){return [0,50];},
  def:function(i){return HW3HS_DEF[i];},
  dirty:hw3HSDirty
});
var _slewImpl=makeStepper({
  idOf:function(){return 'cSlewRate';},
  paramOf:function(){return 'hw3SlewRate';},
  range:function(){return [1,25];},
  def:function(){return SLEW_DEF;},
  dirty:'slew',
  onChange:function(nv){ var e=document.getElementById('cSlewKphHint'); if(e) e.textContent=fmtSlewKph(nv); }
});
function slewStep(delta){ _slewImpl(0, delta); }
var _legacyImpl=makeStepper({
  idOf:function(){return 'cLegOff';},
  paramOf:function(){return 'legacyOffset';},
  range:function(){return [0,33];},
  def:function(){return LEGACY_DEF;},
  dirty:'legacy'
});
function legacyStep(delta){ _legacyImpl(0, delta); }
var _hw4OffImpl=makeStepper({
  idOf:function(){return 'cHw4Off';},
  paramOf:function(){return 'hw4Offset';},
  range:function(){return [0,21];},
  def:function(){return HW4OFF_DEF;},
  dirty:'hw4off',
  onChange:function(nv){ var k=document.getElementById('cHw4OffKmh'); if(k) k.textContent=hw4RawToKph(nv); }
});
function hw4Step(delta){ _hw4OffImpl(0, delta); }
function hint(msg){ toast(msg, '', 3500); }

// Inject ts-step cells for the two HW3 grids at init — eliminates ~3KB of repeated PROGMEM HTML.
(function initSteppers(){
  var g=document.getElementById('gridHw3CT');
  if(g){
    var ctLbl=[30,40,50,60,70], h='';
    for(var i=0;i<5;i++){
      h+='<div><div class="hw3ct-label">限速 '+ctLbl[i]+'</div><div class="hw3ct-sub">最大 '+HW3CT_RANGE[i][1]+'</div>'
       + '<div class="ts-step"><button class="ts-step-btn" onclick="hw3CtStep('+i+',-1)">−</button>'
       + '<div class="ts-step-val"><span id="hw3CT'+i+'">--</span><span class="ts-step-unit">km/h</span></div>'
       + '<button class="ts-step-btn" onclick="hw3CtStep('+i+',1)">+</button></div></div>';
    }
    g.innerHTML=h;
  }
  var g2=document.getElementById('gridHw3Hs');
  if(g2){
    var hsLbl=['80','90','100','110','120+'], hsMax=[40,45,50,55,60], h2='';
    for(var j=0;j<5;j++){
      h2+='<div><div class="hw3ct-label">限速 '+hsLbl[j]+'</div><div class="hw3ct-sub">上限 +'+hsMax[j]+'</div>'
        + '<div class="ts-step"><button class="ts-step-btn" onclick="hw3HsStep('+j+',-5)">−</button>'
        + '<div class="ts-step-val"><span class="ts-step-pfx">+</span><span id="hw3HsPct'+j+'">--</span><span class="ts-step-unit">%</span></div>'
        + '<button class="ts-step-btn" onclick="hw3HsStep('+j+',5)">+</button></div></div>';
    }
    g2.innerHTML=h2;
  }
})();

// ───── DNS 预设 ─────
var DNS_PRESETS = {
  tesla_min: {
    allow: 'connman.vn.cloud.tesla.cn nav-prd-maps.tesla.cn hermes-prd.vn.cloud.tesla.cn signaling.vn.cloud.tesla.cn api-prd.vn.cloud.tesla.cn media-server-me.tesla.cn www.tesla.cn maps-cn-prd.go.tesla.services volcengine.com volces.com volcengineapi.com volccdn.com api.map.baidu.com lc.map.baidu.com newvector.map.baidu.com route.map.baidu.com newclient.map.baidu.com tracknavi.baidu.com itsmap3.baidu.com app.navi.baidu.com mapapip0.bdimg.com mapapisp0.bdimg.com automap0.bdimg.com baidunavi.cdn.bcebos.com lbsnavi.cdn.bcebos.com enlargeroad-view.su.bcebos.com',
    block: 'tesla.cn tesla.com teslamotors.com tesla.services'
  },
  tesla_lean: {
    allow: 'connman.vn.cloud.tesla.cn www.tesla.cn nav-prd-maps.tesla.cn maps-cn-prd.go.tesla.services hermes-prd.vn.cloud.tesla.cn signaling.vn.cloud.tesla.cn hermes-stream-prd.vn.cloud.tesla.cn api-prd.vn.cloud.tesla.cn media-server-me.tesla.cn',
    block: 'tesla.cn tesla.com tesla.services'
  },
  bl_telemetry: { allow:'', block:'apigateway-x2-trigger.tesla.cn telemetry-prd.vn.cloud.tesla.cn hermes-stream-prd.vn.cloud.tesla.cn' },
  clear: { allow:'', block:'' }
};
var PRESET_IDS = { tesla_min:'pstTesla', tesla_lean:'pstLean', bl_telemetry:'pstBl', clear:'pstClr' };
function normList(s){ return String(s||'').trim().split(/\s+/).filter(Boolean).sort().join(' '); }
function detectActivePreset(allow, block){
  var a = normList(allow), b = normList(block);
  for(var k in DNS_PRESETS){
    if(normList(DNS_PRESETS[k].allow) === a && normList(DNS_PRESETS[k].block) === b) return k;
  }
  return null;
}
var PRESET_NAMES = {
  tesla_min: '⭐ Tesla 推荐（实测）',
  tesla_lean: '🔹 精简官方',
  bl_telemetry: '只屏蔽遥测',
  clear: '清空所有规则'
};
function highlightPreset(allow, block){
  var active = detectActivePreset(allow, block);
  for(var k in PRESET_IDS){
    var el = document.getElementById(PRESET_IDS[k]);
    if(el) el.classList.toggle('active', k === active);
  }
  var stat = document.getElementById('dnsPresetStat');
  if(!stat) return;
  if(active){
    stat.innerHTML = '当前：<span style="color:#34d399">'+ (PRESET_NAMES[active] || active) +'</span>';
  } else {
    var aw = String(allow||'').trim().split(/\s+/).filter(Boolean).length;
    var bk = String(block||'').trim().split(/\s+/).filter(Boolean).length;
    stat.innerHTML = '当前：<span style="color:#fbbf24">✍️ 自定义规则</span>（白名单 '+aw+' · 黑名单 '+bk+'）';
  }
}
function setIpBlk(v){
  var qs = '?ipBlockerEnabled='+(v?1:0);
  if(tok) qs += '&token='+encodeURIComponent(tok);
  fetch('/api/set'+qs)
    .then(function(r){if(r.status===200){toast('已保存','ok');poll()}else{toast('失败','err')}});
}
function dnsPreset(name){
  var p = DNS_PRESETS[name];
  if(!p) return;
  // Auto-enable the DNS filter for non-clear presets so rules don't sit inert
  // behind an off switch. Clear preset = intentional disable, leave toggle alone.
  var qs = '?dnsAllow='+encodeURIComponent(p.allow)+'&dnsBlock='+encodeURIComponent(p.block);
  if(name!=='clear') qs += '&dnsEnable=1';
  if(tok) qs += '&token='+encodeURIComponent(tok);
  fetch('/api/wifi-bridge/set'+qs)
    .then(function(r){if(r.status===200){toast('预设已应用','ok');brPoll()}else{toast('失败','err')}});
}
// ───── 添加 / 删除上联热点 ─────
function brAdd(){
  var ssid = document.getElementById('brAddSsid').value.trim();
  var pass = document.getElementById('brAddPass').value;
  var msg = document.getElementById('brAddMsg');
  if(!ssid){ msg.style.display=''; msg.textContent='⚠️ 请填写 SSID'; msg.style.color='#fca5a5'; return; }
  if(ssid.length > 32 || pass.length > 63){ msg.style.display=''; msg.textContent='⚠️ SSID ≤32 / 密码 ≤63'; msg.style.color='#fca5a5'; return; }
  var qs = 'ssid='+encodeURIComponent(ssid)+'&pass='+encodeURIComponent(pass);
  if(tok) qs += '&token='+encodeURIComponent(tok);
  fetch('/api/wifi-bridge/add?'+qs).then(function(r){
    if(r.status===200){
      msg.style.display=''; msg.textContent='✓ 已添加'; msg.style.color='#34d399';
      document.getElementById('brAddSsid').value = '';
      document.getElementById('brAddPass').value = '';
      brPoll();
    } else if(r.status===403){ showPin(); }
    else r.text().then(function(t){ msg.style.display=''; msg.textContent='✘ '+(t||'失败'); msg.style.color='#fca5a5'; });
  });
}
function brDelConfirm(ssid){
  // 展开当前行的内联确认（绿/红按钮），避免 native confirm
  var row = document.querySelector('[data-del-ssid="'+ssid.replace(/"/g,'&quot;')+'"]');
  if(row) row.style.display = '';
}
function brDelCancel(ssid){
  var row = document.querySelector('[data-del-ssid="'+ssid.replace(/"/g,'&quot;')+'"]');
  if(row) row.style.display = 'none';
}
function brDelDo(ssid){
  fetch('/api/wifi-bridge/delete?ssid='+encodeURIComponent(ssid)+(tok?'&token='+encodeURIComponent(tok):''))
    .then(function(r){
      if(r.status===200){ toast('已删除','ok'); brPoll(); }
      else if(r.status===403){ showPin(); }
      else { toast('删除失败','err'); }
    });
}

// ───── 操作 ─────
function showRebootConfirm(){ document.getElementById('rebootConfirmBox').style.display=''; }
function hideRebootConfirm(){ document.getElementById('rebootConfirmBox').style.display='none'; }
function showFactoryConfirm(){ document.getElementById('factoryConfirmBox').style.display=''; }
function hideFactoryConfirm(){ document.getElementById('factoryConfirmBox').style.display='none'; }
function doReboot(){
  hideRebootConfirm();
  fetch('/api/reboot'+authSuffix()).then(function(){toast('正在重启...','ok')});
}
function doFactory(){
  hideFactoryConfirm();
  var fd = new FormData(); fd.append('confirm','YES');
  fetch('/api/reset'+(tok?'?token='+encodeURIComponent(tok):''),{method:'POST',body:fd})
    .then(function(){toast('出厂重置中...','ok')});
}
function openPhone(){location.href='/?ui=phone'}

// ───── 诊断日志 ─────
function logRefresh(){
  var el = document.getElementById('diagLog');
  fetch('/api/log'+authSuffix())
    .then(function(r){ if(r.status===403){ showPin(); return ''; } return r.text(); })
    .then(function(txt){ if(txt==null) return; el.value = txt || '(暂无日志)'; el.scrollTop = el.scrollHeight; })
    .catch(function(){ toast('日志加载失败','err'); });
}
function logCopy(){
  var el = document.getElementById('diagLog');
  if(navigator.clipboard && navigator.clipboard.writeText){
    navigator.clipboard.writeText(el.value).then(
      function(){ toast('日志已复制','ok'); },
      function(){ el.select(); document.execCommand('copy'); toast('已选中，请手动复制','ok'); }
    );
  } else {
    el.select(); document.execCommand('copy'); toast('已选中，请手动复制','ok');
  }
}
function showLogClear(){ document.getElementById('logClearBox').style.display=''; }
function hideLogClear(){ document.getElementById('logClearBox').style.display='none'; }
function logClear(){
  hideLogClear();
  fetch('/api/log/clear'+(tok?'?token='+encodeURIComponent(tok):''), {method:'POST'})
    .then(function(r){ if(r.status===200){ toast('日志已清除','ok'); logRefresh(); } else if(r.status===403){ showPin(); } else toast('清除失败','err'); });
}

// ───── OTA ─────
var otaSelected = null;
function otaPick(){ document.getElementById('otaFile').click() }
document.getElementById('otaFile').addEventListener('change', function(e){
  var f = e.target.files[0];
  if(!f) return;
  otaSelected = f;
  document.getElementById('otaFname').textContent = f.name + ' ('+Math.round(f.size/1024)+' KB)';
  var btn = document.getElementById('otaUp');
  btn.disabled = false; btn.style.opacity = 1;
});
function showOtaConfirm(){
  if(!otaSelected) return;
  document.getElementById('otaConfirmName').textContent = otaSelected.name;
  document.getElementById('otaConfirmBox').style.display = '';
}
function hideOtaConfirm(){ document.getElementById('otaConfirmBox').style.display = 'none'; }
function otaUpload(){
  if(!otaSelected) return;
  hideOtaConfirm();
  var btn = document.getElementById('otaUp');
  var box = document.getElementById('progBox');
  var bar = document.getElementById('progBar');
  function restore(){ btn.disabled=false; btn.style.opacity=1; box.style.display='none'; bar.style.width='0%'; }
  btn.disabled = true; btn.style.opacity = .5;
  box.style.display = 'block'; bar.style.width = '0%';
  var fd = new FormData();
  fd.append('update', otaSelected, otaSelected.name);
  var xhr = new XMLHttpRequest();
  xhr.open('POST', '/api/ota'+(tok?'?token='+encodeURIComponent(tok):''));
  xhr.upload.onprogress = function(e){
    if(e.lengthComputable) bar.style.width = (e.loaded/e.total*100)+'%';
  };
  xhr.onload = function(){
    if(xhr.status===200){
      toast('升级成功，模块重启中...','ok');
      setTimeout(function(){location.reload()}, 8000);
    } else {
      toast('升级失败: '+(xhr.responseText||xhr.status),'err');
      restore();
    }
  };
  xhr.onerror = function(){ toast('网络错误','err'); restore(); };
  xhr.onabort = function(){ restore(); };
  xhr.send(fd);
}

// ───── 在线 OTA（GitHub） ─────
var __otaOnlinePoll = null;
function otaRenderOnline(s){
  var cur = document.getElementById('otaCur');
  var lat = document.getElementById('otaLat');
  var env = document.getElementById('otaEnv');
  var msg = document.getElementById('otaOnlineMsg');
  var box = document.getElementById('otaDlBox');
  var bar = document.getElementById('otaDlBar');
  var chk = document.getElementById('otaChkBtn');
  var pull = document.getElementById('otaPullBtn');
  if(s.current) cur.textContent = 'v'+s.current;
  if(s.envTag)  env.textContent = s.envTag;
  // Track latest release version so /api/ota/notes can be fetched on demand
  // (kept off the hot-path /api/ota/status poll).
  if(s.latest && __carOtaNotesVersion!==s.latest){__carOtaNotesVersion=s.latest;__carOtaNotesCache=null;}
  var notesRow=document.getElementById('carOtaNotesRow');
  if(notesRow){notesRow.style.display = (s.hasNotes && s.latest) ? '' : 'none';}
  function setBtn(b, on){ b.disabled=!on; b.style.opacity = on?1:.5; }
  if(s.state===1){ msg.textContent='正在查询 GitHub…'; msg.style.color='#a0a0a0'; setBtn(chk,false); setBtn(pull,false); }
  else if(s.state===2){ msg.textContent='正在下载…'; msg.style.color='#fff'; box.style.display='block'; setBtn(chk,false); setBtn(pull,false); }
  else if(s.state===3){ box.style.display='block'; var pct=s.total>0?Math.round(s.written/s.total*100):0; bar.style.width=pct+'%'; msg.textContent='正在写入 '+pct+'%'; msg.style.color='#fff'; setBtn(chk,false); setBtn(pull,false); }
  else if(s.state===4){ if(s.latest) lat.textContent='v'+s.latest; msg.textContent=s.message||'已找到新版本'; msg.style.color='#22c55e'; setBtn(chk,true); setBtn(pull,!!s.url); if(__otaOnlinePoll){clearInterval(__otaOnlinePoll);__otaOnlinePoll=null;} }
  else if(s.state===5){ msg.textContent=s.message||'更新成功，正在重启…'; msg.style.color='#22c55e'; bar.style.width='100%'; setBtn(chk,false); setBtn(pull,false); if(__otaOnlinePoll){clearInterval(__otaOnlinePoll);__otaOnlinePoll=null;} setTimeout(function(){location.reload()}, 8000); }
  else if(s.state===6){ msg.textContent=s.message||'失败'; msg.style.color='#ef4444'; setBtn(chk,true); setBtn(pull,!!s.url); if(__otaOnlinePoll){clearInterval(__otaOnlinePoll);__otaOnlinePoll=null;} }
  else { setBtn(chk,true); setBtn(pull,!!s.url); }
}
function otaStartOnlinePoll(){
  if(__otaOnlinePoll) clearInterval(__otaOnlinePoll);
  var tick = function(){
    fetch('/api/ota/status'+(tok?'?token='+encodeURIComponent(tok):''))
      .then(function(r){ return r.ok?r.json():null; })
      .then(function(j){ if(j) otaRenderOnline(j); })
      .catch(function(){});
  };
  tick();
  __otaOnlinePoll = setInterval(tick, 1500);
}
function otaCheck(){
  var msg = document.getElementById('otaOnlineMsg');
  msg.textContent = ''; msg.style.color='#a0a0a0';
  document.getElementById('otaChkBtn').disabled = true;
  fetch('/api/ota/check'+(tok?'?token='+encodeURIComponent(tok):''), {method:'POST'})
    .then(function(r){
      if(r.status===403){ showPin(); document.getElementById('otaChkBtn').disabled=false; return; }
      if(!r.ok){ msg.textContent='HTTP '+r.status; msg.style.color='#ef4444'; document.getElementById('otaChkBtn').disabled=false; return; }
      otaStartOnlinePoll();
    })
    .catch(function(){ msg.textContent='网络错误'; msg.style.color='#ef4444'; document.getElementById('otaChkBtn').disabled=false; });
}
function otaPull(){
  if(!confirm('确认下载并安装新版？期间请勿断电')) return;
  var msg = document.getElementById('otaOnlineMsg');
  msg.textContent = ''; msg.style.color='#a0a0a0';
  document.getElementById('otaPullBtn').disabled = true;
  document.getElementById('otaChkBtn').disabled = true;
  fetch('/api/ota/pull'+(tok?'?token='+encodeURIComponent(tok):''), {method:'POST'})
    .then(function(r){
      if(r.status===403){ showPin(); return; }
      if(!r.ok){ msg.textContent='HTTP '+r.status; msg.style.color='#ef4444'; return; }
      otaStartOnlinePoll();
    })
    .catch(function(){ msg.textContent='网络错误'; msg.style.color='#ef4444'; });
}
// Minimal markdown → HTML for release notes. Tesla black/white theme variant.
// HTML-escapes all input first (defends against XSS via crafted release body).
// Supports # ## ### headings, ``` fenced code, `inline` code, **bold**,
// *italic*, [text](url) links, `- ` and `1. ` lists, GitHub-style tables,
// `---` horizontal rule. Unknown markup falls through as escaped text.
function carMdMini(src){
  if(!src)return'';
  var esc=function(s){return s.replace(/&/g,'&amp;').replace(/</g,'&lt;').replace(/>/g,'&gt;').replace(/"/g,'&quot;');};
  var inline=function(s){
    s=esc(s);
    s=s.replace(/`([^`]+)`/g,'<code style="background:#000;padding:1px 6px;border:1px solid #333;border-radius:3px;font-family:monospace;font-size:0.92em">$1</code>');
    s=s.replace(/\*\*([^*]+)\*\*/g,'<strong>$1</strong>');
    s=s.replace(/(^|[^*])\*([^*\s][^*]*?)\*/g,'$1<em>$2</em>');
    s=s.replace(/\[([^\]]+)\]\((https?:\/\/[^\s)]+)\)/g,'<a href="$2" target="_blank" rel="noopener" style="color:#fff;text-decoration:underline">$1</a>');
    return s;
  };
  var lines=src.replace(/\r\n/g,'\n').split('\n');
  var out=[],i=0,inCode=false,codeBuf=[],listType=null,tableRows=null,tableAligns=null;
  var closeList=function(){if(listType){out.push('</'+listType+'>');listType=null;}};
  var closeTable=function(){
    if(!tableRows)return;
    var html='<div style="overflow-x:auto"><table style="border-collapse:collapse;width:100%;font-size:0.92em;margin:8px 0">';
    for(var r=0;r<tableRows.length;r++){
      var tag=r===0?'th':'td';
      var bg=r===0?'background:#1a1a1a;':'';
      html+='<tr>';
      for(var c=0;c<tableRows[r].length;c++){
        var al=tableAligns&&tableAligns[c]?'text-align:'+tableAligns[c]+';':'';
        html+='<'+tag+' style="border:1px solid #333;padding:6px 10px;'+bg+al+'">'+inline(tableRows[r][c])+'</'+tag+'>';
      }
      html+='</tr>';
    }
    html+='</table></div>';
    out.push(html);
    tableRows=null;tableAligns=null;
  };
  while(i<lines.length){
    var ln=lines[i];
    if(inCode){
      if(/^```/.test(ln)){
        out.push('<pre style="background:#000;border:1px solid #333;padding:10px;border-radius:6px;overflow-x:auto;font-family:monospace;font-size:0.88em">'+esc(codeBuf.join('\n'))+'</pre>');
        codeBuf=[];inCode=false;
      } else codeBuf.push(ln);
      i++;continue;
    }
    if(/^```/.test(ln)){closeList();closeTable();inCode=true;i++;continue;}
    var isTable=/^\s*\|.*\|\s*$/.test(ln) && i+1<lines.length && /^\s*\|?[\s:|-]+\|?\s*$/.test(lines[i+1]) && /[-]/.test(lines[i+1]);
    if(isTable){
      closeList();
      var split=function(row){return row.replace(/^\s*\|/,'').replace(/\|\s*$/,'').split('|').map(function(c){return c.trim();});};
      tableRows=[split(ln)];
      var sep=split(lines[i+1]);
      tableAligns=sep.map(function(s){
        var L=/^:/.test(s),R=/:$/.test(s);
        return L&&R?'center':R?'right':L?'left':'';
      });
      i+=2;
      while(i<lines.length && /^\s*\|.*\|\s*$/.test(lines[i])){tableRows.push(split(lines[i]));i++;}
      closeTable();continue;
    }
    var h=/^(#{1,3})\s+(.+)/.exec(ln);
    if(h){closeList();closeTable();var lv=h[1].length;var sz=lv===1?'1.4em':lv===2?'1.2em':'1.05em';out.push('<h'+lv+' style="margin:14px 0 6px;font-size:'+sz+';color:#fff;font-weight:600">'+inline(h[2])+'</h'+lv+'>');i++;continue;}
    if(/^\s*---+\s*$/.test(ln)){closeList();closeTable();out.push('<hr style="border:none;border-top:1px solid #333;margin:10px 0">');i++;continue;}
    var ul=/^\s*[-*]\s+(.+)/.exec(ln);
    var ol=/^\s*\d+\.\s+(.+)/.exec(ln);
    if(ul||ol){
      var want=ul?'ul':'ol';
      if(listType&&listType!==want){closeList();}
      if(!listType){out.push('<'+want+' style="margin:6px 0 6px 24px;padding:0">');listType=want;}
      out.push('<li style="margin:3px 0">'+inline((ul||ol)[1])+'</li>');
      i++;continue;
    }
    closeList();closeTable();
    if(/^\s*$/.test(ln)){out.push('');i++;continue;}
    out.push('<div style="margin:5px 0">'+inline(ln)+'</div>');
    i++;
  }
  closeList();closeTable();
  if(inCode){out.push('<pre style="background:#000;padding:10px;border-radius:6px">'+esc(codeBuf.join('\n'))+'</pre>');}
  return out.join('\n');
}
var __carOtaNotesCache=null;
var __carOtaNotesVersion='';
function carShowOtaNotes(){
  var ov=document.getElementById('carOtaNotesOverlay');
  var body=document.getElementById('carOtaNotesBody');
  var title=document.getElementById('carOtaNotesTitle');
  var pull=document.getElementById('otaPullBtn');
  var installBtn=document.getElementById('carOtaNotesInstallBtn');
  if(installBtn) installBtn.disabled = pull ? pull.disabled : false;
  if(installBtn) installBtn.style.opacity = installBtn.disabled ? .5 : 1;
  body.innerHTML='<div style="color:#888">加载中…</div>';
  ov.style.display='flex';
  var fetchNotes=function(){
    if(__carOtaNotesCache!==null) return Promise.resolve(__carOtaNotesCache);
    return fetch('/api/ota/notes'+(tok?'?token='+encodeURIComponent(tok):''))
      .then(function(r){return r.ok?r.json():null;})
      .then(function(j){
        if(j && typeof j.notes==='string'){__carOtaNotesCache=j.notes;return j.notes;}
        return null;
      }).catch(function(){return null;});
  };
  fetchNotes().then(function(notes){
    if(__carOtaNotesVersion) title.textContent='v'+__carOtaNotesVersion+' 更新内容';
    body.innerHTML = notes ? carMdMini(notes) : '<div style="color:#888">没有发布说明</div>';
  });
}
function carHideOtaNotes(e){
  if(e && e.target && e.target.id!=='carOtaNotesOverlay')return;
  document.getElementById('carOtaNotesOverlay').style.display='none';
}
function carLoadPartInfo(){
  fetch('/api/ota/partinfo'+(tok?'?token='+encodeURIComponent(tok):''))
    .then(function(r){ return r.ok?r.json():null; })
    .then(function(j){
      if(!j) return;
      var panel = document.getElementById('carRollbackPanel');
      if(!j.canRollback){ if(panel) panel.style.display='none'; return; }
      if(panel) panel.style.display='';
      var prev = document.getElementById('carOtaPrev');
      var pv = j.previous || {};
      var ver = pv.version ? ('v'+pv.version) : '--';
      var date = pv.date ? (' ('+pv.date+')') : '';
      if(prev) prev.textContent = ver + date;
    })
    .catch(function(){});
}
function carDoRollback(){
  if(!confirm('将切换到上一个固件并重启，确定吗？')) return;
  var msg = document.getElementById('carRollbackMsg');
  msg.textContent = ''; msg.style.color='#a0a0a0';
  document.getElementById('carRollbackBtn').disabled = true;
  fetch('/api/ota/rollback'+(tok?'?token='+encodeURIComponent(tok):''), {method:'POST'})
    .then(function(r){
      if(r.status===403){ showPin(); document.getElementById('carRollbackBtn').disabled=false; return; }
      if(r.ok){ msg.textContent='已切换，正在重启...'; msg.style.color='#34d399'; }
      else { msg.textContent='回滚失败'; msg.style.color='#ef4444'; document.getElementById('carRollbackBtn').disabled=false; }
    })
    .catch(function(){ msg.textContent='已切换，正在重启...'; msg.style.color='#34d399'; });
}

// ───── 键盘避让：输入框获得焦点时滚动到视口中央，避免被软键盘挡住 ─────
document.addEventListener('focusin', function(e){
  var t = e.target;
  if (!t || !(t.matches && t.matches('input,textarea'))) return;
  setTimeout(function(){ try { t.scrollIntoView({block:'center',behavior:'smooth'}); } catch(_){} }, 300);
});

// ───── 启动（隐藏时停止轮询，恢复时立即补一次后重启） ─────
var __brPollT = null;
function __startPolls(){
  if(!pollT) pollT = setInterval(poll, 250);
  if(!__brPollT) __brPollT = setInterval(brPoll, 4000);
}
function __stopPolls(){
  if(pollT){ clearInterval(pollT); pollT = null; }
  if(__brPollT){ clearInterval(__brPollT); __brPollT = null; }
}
document.addEventListener('visibilitychange', function(){
  if(document.hidden){ __stopPolls(); }
  else { poll(); brPoll(); __startPolls(); }
});
poll();
brPoll();
__startPolls();

(function installPassEye(){
  var inputs=document.querySelectorAll('input[type=password]');
  var LAYOUT=['flex','flexGrow','flexBasis','flexShrink','minWidth','width','marginBottom','marginTop'];
  for(var i=0;i<inputs.length;i++){
    var inp=inputs[i];
    if(inp.dataset.pwEye)continue;
    inp.dataset.pwEye='1';
    var wrap=document.createElement('span');
    wrap.className='pw-wrap';
    for(var k=0;k<LAYOUT.length;k++){
      var prop=LAYOUT[k];
      if(inp.style[prop]){ wrap.style[prop]=inp.style[prop]; inp.style[prop]=''; }
    }
    inp.parentNode.insertBefore(wrap,inp);
    wrap.appendChild(inp);
    var btn=document.createElement('button');
    btn.type='button';
    btn.className='pw-eye';
    btn.setAttribute('aria-label','显示/隐藏密码');
    btn.tabIndex=-1;
    btn.textContent='👁';
    (function(target,b){
      b.onclick=function(ev){
        ev.preventDefault();
        if(target.type==='password'){ target.type='text'; b.textContent='🙈'; }
        else { target.type='password'; b.textContent='👁'; }
      };
    })(inp,btn);
    wrap.appendChild(btn);
  }
})();
// 折叠 panel 内静态 .tip 为标题旁感叹号 — 点击切换该 panel 全部 tip。
// 复用 .info-ic 视觉，添加 .info-toggle 让其绝对定位到 panel 右上角。
//
// 关于 inline display:none 的 tip：
//   - 初始空（如 brAddMsg 这类动态消息槽）→ 跳过，留给原 JS 控制。
//   - 有内容（如 tipTlssc，HW3/HW4 时 JS 把 inline display 清空让其可见）
//     → 纳入。.tip-collapsed class 与 inline display 协作：inline 'none'
//     时优先隐藏；inline 清空后 class 起作用，初始仍折叠等用户点感叹号。
(function(){
  document.querySelectorAll('.panel').forEach(function(panel){
    var tips = [];
    panel.querySelectorAll('.tip').forEach(function(t){
      if (t.dataset.tipReady) return;
      if (!t.textContent.trim()) return;  // skip empty dynamic-message slots
      t.dataset.tipReady = '1';
      t.classList.add('tip-collapsed');
      tips.push(t);
    });
    if (tips.length === 0) return;
    var btn = document.createElement('span');
    btn.className = 'info-ic info-toggle';
    btn.textContent = 'i';
    btn.title = '查看说明';
    btn.setAttribute('role', 'button');
    btn.setAttribute('aria-label', '查看说明');
    btn.onclick = function(){
      var open = false;
      tips.forEach(function(t){
        var nowHidden = t.classList.toggle('tip-collapsed');
        if (!nowHidden) open = true;
      });
      btn.classList.toggle('active', open);
    };
    panel.appendChild(btn);
  });
})();
</script>
</body>
</html>)rawliteral";
